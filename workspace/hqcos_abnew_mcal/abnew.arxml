AUTOSAR XML (schema 00046)
package /Base
  module config Base: implementation-config-variant=VARIANT-PRE-COMPILE
    CommonPublishedInformation:
      ArReleaseMajorVersion = 4
      ArReleaseMinorVersion = 4
      ArReleaseRevisionVersion = 0
      ModuleId = 0
      SwMajorVersion = 1
      SwMinorVersion = 0
      SwPatchVersion = 1
      VendorId = 43
    OsIfGeneral: OsIfDevErrorDetect=0, OsIfEnableUserModeSupport=0, OsIfInstanceId=0, OsIfMulticoreSupport=0, OsIfUseCustomTimer=0, OsIfUseSystemTimer=0
      OsIfOperatingSystemType
        OsIfOperatingSystemType (OsIfAutosarOsType)
package /Gpt
  module config Gpt: implementation-config-variant=VARIANT-POST-BUILD
    CommonPublishedInformation:
      ArReleaseMajorVersion = 4
      ArReleaseMinorVersion = 4
      ArReleaseRevisionVersion = 0
      ModuleId = 100
      SwMajorVersion = 1
      SwMinorVersion = 0
      SwPatchVersion = 1
      VendorId = 43
    GptAutosarExt: ChainModeApi=0, GptChangeNextTimeoutValueApi=0, GptEnableDualClockMode=0, GptEnableTriggers=0, GptEnableUserModeSupport=0, GptStandbyWakeupSupport=0
    GptChannelConfigSet
      3 x GptChannelConfiguration, all with GptEnableWakeup=0:
        GptChannelConfiguration_WdgTrig: index=0, GptChannelId=0, GptChannelMode=GPT_CH_MODE_CONTINUOUS, GptChannelTickFrequency=8000000.0, GptChannelTickValueMax=4294967295, GptHwIp=LPIT, GptNotification=Wdg_Cbk_GptNotification0, GptChannelClkSrcRef=GptClockReferencePoint_SOSCDIV2_CLK, GptModuleRef=GptLpitChannels_0
        GptChannelConfiguration_0: index=1, GptChannelId=1, GptChannelMode=GPT_CH_MODE_ONESHOT, GptChannelTickFrequency=1000000.0, GptChannelTickValueMax=65535, GptHwIp=LPTMR, GptChannelClkSrcRef=GptClockReferencePoint_SIRCDIV2_CLK, GptModuleRef=GptLptmr_0
        GptChannelConfiguration_WdgTrig_43: index=2, GptChannelId=2, GptChannelMode=GPT_CH_MODE_ONESHOT, GptChannelTickFrequency=8000000.0, GptChannelTickValueMax=4294967295, GptHwIp=LPIT, GptNotification=Wdg_Cbk_GptNotification1, GptChannelClkSrcRef=GptClockReferencePoint_SOSCDIV2_CLK, GptModuleRef=GptLpitChannels_1
      GptLpit_0 (GptLpit): GptLpitModule=LPIT_0, LpitDozeEnable=0, LpitFreezeEnable=0
        GptLpitChannels_0 (GptLpitChannels): ChainMode=0, GptLpitChannel=CH_0, LPitExternalTrigger=0, LPitReloadOnTrigger=0, LPitStartOnTrigger=0, LPitStopOnInterrupt=0
        GptLpitChannels_1 (GptLpitChannels): ChainMode=0, GptLpitChannel=CH_1, LPitExternalTrigger=0, LPitReloadOnTrigger=0, LPitStartOnTrigger=0, LPitStopOnInterrupt=0
      GptLptmr_0 (GptLptmr): GptLptmrAlternatePrescaler=2, GptLptmrChannelClkSrc=LPTMR_GPT_IP_CLOCK_SIRCDIV2, GptLptmrModule=LPTMR_0_CH_0, GptLptmrPrescaler=4, PrescalerEnable=1
    GptConfigurationOfOptApiServices:
      GptDeinitApi = 1
      GptEnableDisableNotificationApi = 1
      GptPredefTimerFunctionalityApi = 1
      GptTimeElapsedApi = 1
      GptTimeRemainingApi = 1
      GptVersionInfoApi = 1
      GptWakeupFunctionalityApi = 1
    GptDriverConfiguration:
      GptDevErrorDetect = 0
      GptMulticoreSupport = 0
      GptPredefTimer100us32bitEnable = 0
      GptPredefTimer1usEnablingGrade = GPT_PREDEF_TIMER_1US_16BIT_ENABLED
      GptReportWakeupSource = 1
      GptTimeoutDuration = 800
      GptTimeoutMethod = OSIF_COUNTER_DUMMY
      7 x GptClockReferencePoint:
        GptClockReferencePoint_BUS_CLK: GptClockReference=McuClockReferencePoint_BUS_CLK
        GptClockReferencePoint_LPO128K_CLK: GptClockReference=McuClockReferencePoint_LPO128K_CLK
        GptClockReferencePoint_SIRCDIV2_CLK: GptClockReference=McuClockReferencePoint_SIRCDIV2_CLK
        GptClockReferencePoint_SIRC_CLK: GptClockReference=McuClockReferencePoint_SIRC_CLK
        GptClockReferencePoint_SOSCDIV2_CLK: GptClockReference=McuClockReferencePoint_SOSCDIV2_CLK
        GptClockReferencePoint_SPLLDIV2_CLK: GptClockReference=McuClockReferencePoint_SPLLDIV2_CLK
        GptClockReferencePoint_SYS_CLK: GptClockReference=McuClockReferencePoint_SYS_CLK
    78 x GptHwConfiguration:
      GptHwConfiguration_0: index=0, GptChannelIsUsed=1, GptIsrEnable=1, GptIsrHwId=LPIT_0_CH_0
      GptHwConfiguration_1: index=1, GptChannelIsUsed=1, GptIsrEnable=1, GptIsrHwId=LPIT_0_CH_1
      GptHwConfiguration_2: index=2, GptChannelIsUsed=0, GptIsrEnable=0, GptIsrHwId=LPIT_0_CH_2
      GptHwConfiguration_3: index=3, GptChannelIsUsed=0, GptIsrEnable=0, GptIsrHwId=LPIT_0_CH_3
      GptHwConfiguration_4: index=4, GptChannelIsUsed=1, GptIsrEnable=1, GptIsrHwId=FTM_0_CH_0
      GptHwConfiguration_5: index=5, GptChannelIsUsed=1, GptIsrEnable=1, GptIsrHwId=FTM_0_CH_1
      GptHwConfiguration_6: index=6, GptChannelIsUsed=0, GptIsrEnable=0, GptIsrHwId=FTM_0_CH_2
      GptHwConfiguration_7: index=7, GptChannelIsUsed=0, GptIsrEnable=0, GptIsrHwId=FTM_0_CH_3
      GptHwConfiguration_8: index=8, GptChannelIsUsed=0, GptIsrEnable=0, GptIsrHwId=FTM_0_CH_4
      GptHwConfiguration_9: index=9, GptChannelIsUsed=0, GptIsrEnable=0, GptIsrHwId=FTM_0_CH_5
      GptHwConfiguration_10: index=10, GptChannelIsUsed=0, GptIsrEnable=0, GptIsrHwId=FTM_0_CH_6
      GptHwConfiguration_11: index=11, GptChannelIsUsed=0, GptIsrEnable=0, GptIsrHwId=FTM_0_CH_7
      GptHwConfiguration_12: index=12, GptChannelIsUsed=0, GptIsrEnable=0, GptIsrHwId=FTM_1_CH_0
      GptHwConfiguration_13: index=13, GptChannelIsUsed=0, GptIsrEnable=0, GptIsrHwId=FTM_1_CH_1
      GptHwConfiguration_14: index=14, GptChannelIsUsed=0, GptIsrEnable=0, GptIsrHwId=FTM_1_CH_2
      GptHwConfiguration_15: index=15, GptChannelIsUsed=0, GptIsrEnable=0, GptIsrHwId=FTM_1_CH_3
      GptHwConfiguration_16: index=16, GptChannelIsUsed=0, GptIsrEnable=0, GptIsrHwId=FTM_1_CH_4
      GptHwConfiguration_17: index=17, GptChannelIsUsed=0, GptIsrEnable=0, GptIsrHwId=FTM_1_CH_5
      GptHwConfiguration_18: index=18, GptChannelIsUsed=0, GptIsrEnable=0, GptIsrHwId=FTM_1_CH_6
      GptHwConfiguration_19: index=19, GptChannelIsUsed=0, GptIsrEnable=0, GptIsrHwId=FTM_1_CH_7
      GptHwConfiguration_20: index=20, GptChannelIsUsed=0, GptIsrEnable=0, GptIsrHwId=FTM_2_CH_0
      GptHwConfiguration_21: index=21, GptChannelIsUsed=0, GptIsrEnable=0, GptIsrHwId=FTM_2_CH_1
      GptHwConfiguration_22: index=22, GptChannelIsUsed=0, GptIsrEnable=0, GptIsrHwId=FTM_2_CH_2
      GptHwConfiguration_23: index=23, GptChannelIsUsed=0, GptIsrEnable=0, GptIsrHwId=FTM_2_CH_3
      GptHwConfiguration_24: index=24, GptChannelIsUsed=0, GptIsrEnable=0, GptIsrHwId=FTM_2_CH_4
      GptHwConfiguration_25: index=25, GptChannelIsUsed=0, GptIsrEnable=0, GptIsrHwId=FTM_2_CH_5
      GptHwConfiguration_26: index=26, GptChannelIsUsed=0, GptIsrEnable=0, GptIsrHwId=FTM_2_CH_6
      GptHwConfiguration_27: index=27, GptChannelIsUsed=0, GptIsrEnable=0, GptIsrHwId=FTM_2_CH_7
      GptHwConfiguration_28: index=28, GptChannelIsUsed=0, GptIsrEnable=0, GptIsrHwId=FTM_3_CH_0
      GptHwConfiguration_29: index=29, GptChannelIsUsed=0, GptIsrEnable=0, GptIsrHwId=FTM_3_CH_1
      GptHwConfiguration_30: index=30, GptChannelIsUsed=0, GptIsrEnable=0, GptIsrHwId=FTM_3_CH_2
      GptHwConfiguration_31: index=31, GptChannelIsUsed=0, GptIsrEnable=0, GptIsrHwId=FTM_3_CH_3
      GptHwConfiguration_32: index=32, GptChannelIsUsed=0, GptIsrEnable=0, GptIsrHwId=FTM_3_CH_4
      GptHwConfiguration_33: index=33, GptChannelIsUsed=0, GptIsrEnable=0, GptIsrHwId=FTM_3_CH_5
      GptHwConfiguration_34: index=34, GptChannelIsUsed=0, GptIsrEnable=0, GptIsrHwId=FTM_3_CH_6
      GptHwConfiguration_35: index=35, GptChannelIsUsed=0, GptIsrEnable=0, GptIsrHwId=FTM_3_CH_7
      GptHwConfiguration_36: index=36, GptChannelIsUsed=0, GptIsrEnable=0, GptIsrHwId=FTM_4_CH_0
      GptHwConfiguration_37: index=37, GptChannelIsUsed=0, GptIsrEnable=0, GptIsrHwId=FTM_4_CH_1
      GptHwConfiguration_38: index=38, GptChannelIsUsed=0, GptIsrEnable=0, GptIsrHwId=FTM_4_CH_2
      GptHwConfiguration_39: index=39, GptChannelIsUsed=0, GptIsrEnable=0, GptIsrHwId=FTM_4_CH_3
      GptHwConfiguration_40: index=40, GptChannelIsUsed=0, GptIsrEnable=0, GptIsrHwId=FTM_4_CH_4
      GptHwConfiguration_41: index=41, GptChannelIsUsed=0, GptIsrEnable=0, GptIsrHwId=FTM_4_CH_5
      GptHwConfiguration_42: index=42, GptChannelIsUsed=0, GptIsrEnable=0, GptIsrHwId=FTM_4_CH_6
      GptHwConfiguration_43: index=43, GptChannelIsUsed=0, GptIsrEnable=0, GptIsrHwId=FTM_4_CH_7
      GptHwConfiguration_44: index=44, GptChannelIsUsed=0, GptIsrEnable=0, GptIsrHwId=FTM_5_CH_0
      GptHwConfiguration_45: index=45, GptChannelIsUsed=0, GptIsrEnable=0, GptIsrHwId=FTM_5_CH_1
      GptHwConfiguration_46: index=46, GptChannelIsUsed=0, GptIsrEnable=0, GptIsrHwId=FTM_5_CH_2
      GptHwConfiguration_47: index=47, GptChannelIsUsed=0, GptIsrEnable=0, GptIsrHwId=FTM_5_CH_3
      GptHwConfiguration_48: index=48, GptChannelIsUsed=0, GptIsrEnable=0, GptIsrHwId=FTM_5_CH_4
      GptHwConfiguration_49: index=49, GptChannelIsUsed=0, GptIsrEnable=0, GptIsrHwId=FTM_5_CH_5
      GptHwConfiguration_50: index=50, GptChannelIsUsed=0, GptIsrEnable=0, GptIsrHwId=FTM_5_CH_6
      GptHwConfiguration_51: index=51, GptChannelIsUsed=0, GptIsrEnable=0, GptIsrHwId=FTM_5_CH_7
      GptHwConfiguration_52: index=52, GptChannelIsUsed=0, GptIsrEnable=0, GptIsrHwId=FTM_6_CH_0
      GptHwConfiguration_53: index=53, GptChannelIsUsed=0, GptIsrEnable=0, GptIsrHwId=FTM_6_CH_1
      GptHwConfiguration_54: index=54, GptChannelIsUsed=0, GptIsrEnable=0, GptIsrHwId=FTM_6_CH_2
      GptHwConfiguration_55: index=55, GptChannelIsUsed=0, GptIsrEnable=0, GptIsrHwId=FTM_6_CH_3
      GptHwConfiguration_56: index=56, GptChannelIsUsed=0, GptIsrEnable=0, GptIsrHwId=FTM_6_CH_4
      GptHwConfiguration_57: index=57, GptChannelIsUsed=0, GptIsrEnable=0, GptIsrHwId=FTM_6_CH_5
      GptHwConfiguration_58: index=58, GptChannelIsUsed=0, GptIsrEnable=0, GptIsrHwId=FTM_6_CH_6
      GptHwConfiguration_59: index=59, GptChannelIsUsed=0, GptIsrEnable=0, GptIsrHwId=FTM_6_CH_7
      GptHwConfiguration_60: index=60, GptChannelIsUsed=0, GptIsrEnable=0, GptIsrHwId=FTM_7_CH_0
      GptHwConfiguration_61: index=61, GptChannelIsUsed=0, GptIsrEnable=0, GptIsrHwId=FTM_7_CH_1
      GptHwConfiguration_62: index=62, GptChannelIsUsed=0, GptIsrEnable=0, GptIsrHwId=FTM_7_CH_2
      GptHwConfiguration_63: index=63, GptChannelIsUsed=0, GptIsrEnable=0, GptIsrHwId=FTM_7_CH_3
      GptHwConfiguration_64: index=64, GptChannelIsUsed=0, GptIsrEnable=0, GptIsrHwId=FTM_7_CH_4
      GptHwConfiguration_65: index=65, GptChannelIsUsed=0, GptIsrEnable=0, GptIsrHwId=FTM_7_CH_5
      GptHwConfiguration_66: index=66, GptChannelIsUsed=0, GptIsrEnable=0, GptIsrHwId=FTM_7_CH_6
      GptHwConfiguration_67: index=67, GptChannelIsUsed=0, GptIsrEnable=0, GptIsrHwId=FTM_7_CH_7
      GptHwConfiguration_68: index=68, GptChannelIsUsed=1, GptIsrEnable=1, GptIsrHwId=LPTMR_0_CH_0
      GptHwConfiguration_69: index=69, GptChannelIsUsed=0, GptIsrEnable=0, GptIsrHwId=SRTC_0_CH_0
      GptHwConfiguration_70: index=70, GptChannelIsUsed=1, GptIsrEnable=0, GptIsrHwId=FTM_0_PREDEF
      GptHwConfiguration_71: index=71, GptChannelIsUsed=0, GptIsrEnable=0, GptIsrHwId=FTM_1_PREDEF
      GptHwConfiguration_72: index=72, GptChannelIsUsed=0, GptIsrEnable=0, GptIsrHwId=FTM_2_PREDEF
      GptHwConfiguration_73: index=73, GptChannelIsUsed=0, GptIsrEnable=0, GptIsrHwId=FTM_3_PREDEF
      GptHwConfiguration_74: index=74, GptChannelIsUsed=0, GptIsrEnable=0, GptIsrHwId=FTM_4_PREDEF
      GptHwConfiguration_75: index=75, GptChannelIsUsed=0, GptIsrEnable=0, GptIsrHwId=FTM_5_PREDEF
      GptHwConfiguration_76: index=76, GptChannelIsUsed=0, GptIsrEnable=0, GptIsrHwId=FTM_6_PREDEF
      GptHwConfiguration_77: index=77, GptChannelIsUsed=0, GptIsrEnable=0, GptIsrHwId=FTM_7_PREDEF
    GptPredefTimerConfiguration
      GptPredefTimer_1us_16Bit:
        GptChannelPrescaler = 4
        GptFreezeEnable = 1
        GptFtmChannelClkSrc = FTM_GPT_IP_CLOCK_SOURCE_EXTERNALCLK
        GptHwChannel = FTM_0_PREDEF
        GptChannelClkSrcRef = GptClockReferencePoint_SIRCDIV2_CLK
package /Lin
  module config Lin: implementation-config-variant=VARIANT-POST-BUILD
    AutosarExt: LinDisableDemReportErrorStatus=0, LinEnableUserModeSupport=0, LinFrameTimeoutDisable=1
    CommonPublishedInformation:
      ArReleaseMajorVersion = 4
      ArReleaseMinorVersion = 4
      ArReleaseRevisionVersion = 0
      ModuleId = 82
      SwMajorVersion = 1
      SwMinorVersion = 0
      SwPatchVersion = 1
      VendorId = 43
    LinGeneral: LinDevErrorDetect=0, LinIndex=0, LinMulticoreSupport=0, LinTimeoutDuration=1000, LinTimeoutMethod=OSIF_COUNTER_DUMMY, LinVersionInfoApi=0
    LinGlobalConfig
      LinChannel_0 (LinChannel):
        BreakLength = BL_13
        DetectedBreakLength = BL_11
        LinChannelBaudRate = 9600
        LinChannelId = 0
        LinChannelWakeupSupport = 0
        LinHeaderTimeout = 44
        LinHwChannel = LPUART_IP_2
        LinNodeType = MASTER
        LinResponseTimeout = 14
        LinClockRef = McuClockReferencePoint_SOSCDIV2_CLK
      LinChannel_1 (LinChannel):
        BreakLength = BL_13
        DetectedBreakLength = BL_11
        LinChannelBaudRate = 9600
        LinChannelId = 1
        LinChannelWakeupSupport = 0
        LinHeaderTimeout = 44
        LinHwChannel = LPUART_IP_1
        LinNodeType = MASTER
        LinResponseTimeout = 14
        LinClockRef = McuClockReferencePoint_SOSCDIV2_CLK
package /Uart
  module config Uart: implementation-config-variant=VARIANT-POST-BUILD, post-build-variant-used=true
    CommonPublishedInformation:
      ArReleaseMajorVersion = 4
      ArReleaseMinorVersion = 4
      ArReleaseRevisionVersion = 0
      ModuleId = 255
      SwMajorVersion = 1
      SwMinorVersion = 0
      SwPatchVersion = 1
      VendorApiInfix = 
      VendorId = 43
    GeneralConfiguration:
      DisableUartRuntimeErrorDetect = 0
      UartCallbackCapability = 0
      UartDevErrorDetect = 1
      UartDmaEnable = 1
      UartEnableUserModeSupport = 0
      UartMulticoreSupport = 0
      UartTimeoutDuration = 1000
      UartTimeoutMethod = OSIF_COUNTER_DUMMY
      UartVersionInfoApi = 1
    UartGlobalConfig
      UartChannel_0 (UartChannel): UartChannelId=0, UartHwUsing=LPUART_IP, UartClockRef=McuClockReferencePoint_SIRCDIV2_CLK
        DetailModuleConfiguration:
          DesireBaudrate = LPUART_UART_BAUDRATE_115200
          UartHwChannel = LPUART_0
          UartInternalLoopbackEnable = 0
          UartInteruptDmaMethod = LPUART_UART_IP_USING_DMA
          UartParityType = LPUART_UART_IP_PARITY_DISABLED
          UartStopBitNumber = LPUART_UART_IP_ONE_STOP_BIT
          UartWordLength = LPUART_UART_IP_8_BITS_PER_CHAR
          UartDmaRxChannelRef = dmaLogicChannel_Uart0_Rx
          UartDmaTxChannelRef = dmaLogicChannel_Uart0_Tx
      UartChannel_1 (UartChannel): UartChannelId=1, UartHwUsing=LPUART_IP, UartClockRef=McuClockReferencePoint_SIRCDIV2_CLK
        DetailModuleConfiguration:
          DesireBaudrate = LPUART_UART_BAUDRATE_115200
          UartHwChannel = LPUART_1
          UartInternalLoopbackEnable = 0
          UartInteruptDmaMethod = LPUART_UART_IP_USING_DMA
          UartParityType = LPUART_UART_IP_PARITY_DISABLED
          UartStopBitNumber = LPUART_UART_IP_ONE_STOP_BIT
          UartWordLength = LPUART_UART_IP_8_BITS_PER_CHAR
          UartDmaRxChannelRef = dmaLogicChannel_Uart1_Tx
          UartDmaTxChannelRef = dmaLogicChannel_Uart1_Tx
package /Fls
  module config Fls: implementation-config-variant=VARIANT-POST-BUILD
    AutosarExt:
      FlsEnableUserModeSupport = 0
      FlsExternalSectorsConfigured = 0
      FlsInternalSectorsConfigured = 1
      FlsInvalidPrefetchBufFromRam = 1
      FlsQspiLockLUT = 0
      FlsSynchronizeCache = 0
    CommonPublishedInformation:
      ArReleaseMajorVersion = 4
      ArReleaseMinorVersion = 4
      ArReleaseRevisionVersion = 0
      ModuleId = 92
      SwMajorVersion = 1
      SwMinorVersion = 0
      SwPatchVersion = 1
      VendorApiInfix = 
      VendorId = 43
    FlsConfigSet:
      FlsAcErase = 1073751296
      FlsAcErasePointer = NULL_PTR
      FlsAcWrite = 1073751296
      FlsAcWritePointer = NULL_PTR
      FlsCallCycle = 0.2
      FlsDefaultMode = MEMIF_MODE_SLOW
      FlsMaxReadFastMode = 1048576
      FlsMaxReadNormalMode = 1024
      FlsMaxWriteFastMode = 256
      FlsMaxWriteNormalMode = 8
      FlsProtection = 0
      FlsSectorList
        16 x FlsSector, all with FlsHwCh=FLS_CH_INTERN, FlsNumberOfSectors=1, FlsPageSize=8, FlsPageWriteAsynch=0, FlsSectorEraseAsynch=0, FlsSectorHwAddress=0, FlsSectorSize=4096:
          FlsSector_0: FlsPhysicalSector=FLS_DATA_ARRAY_0_BLOCK_3_S000, FlsSectorIndex=0, FlsSectorStartaddress=0
          FlsSector_1: FlsPhysicalSector=FLS_DATA_ARRAY_0_BLOCK_3_S001, FlsSectorIndex=1, FlsSectorStartaddress=4096
          FlsSector_10: FlsPhysicalSector=FLS_DATA_ARRAY_0_BLOCK_3_S010, FlsSectorIndex=10, FlsSectorStartaddress=40960
          FlsSector_11: FlsPhysicalSector=FLS_DATA_ARRAY_0_BLOCK_3_S011, FlsSectorIndex=11, FlsSectorStartaddress=45056
          FlsSector_12: FlsPhysicalSector=FLS_DATA_ARRAY_0_BLOCK_3_S012, FlsSectorIndex=12, FlsSectorStartaddress=49152
          FlsSector_13: FlsPhysicalSector=FLS_DATA_ARRAY_0_BLOCK_3_S013, FlsSectorIndex=13, FlsSectorStartaddress=53248
          FlsSector_14: FlsPhysicalSector=FLS_DATA_ARRAY_0_BLOCK_3_S014, FlsSectorIndex=14, FlsSectorStartaddress=57344
          FlsSector_15: FlsPhysicalSector=FLS_DATA_ARRAY_0_BLOCK_3_S015, FlsSectorIndex=15, FlsSectorStartaddress=61440
          FlsSector_2: FlsPhysicalSector=FLS_DATA_ARRAY_0_BLOCK_3_S002, FlsSectorIndex=2, FlsSectorStartaddress=8192
          FlsSector_3: FlsPhysicalSector=FLS_DATA_ARRAY_0_BLOCK_3_S003, FlsSectorIndex=3, FlsSectorStartaddress=12288
          FlsSector_4: FlsPhysicalSector=FLS_DATA_ARRAY_0_BLOCK_3_S004, FlsSectorIndex=4, FlsSectorStartaddress=16384
          FlsSector_5: FlsPhysicalSector=FLS_DATA_ARRAY_0_BLOCK_3_S005, FlsSectorIndex=5, FlsSectorStartaddress=20480
          FlsSector_6: FlsPhysicalSector=FLS_DATA_ARRAY_0_BLOCK_3_S006, FlsSectorIndex=6, FlsSectorStartaddress=24576
          FlsSector_7: FlsPhysicalSector=FLS_DATA_ARRAY_0_BLOCK_3_S007, FlsSectorIndex=7, FlsSectorStartaddress=28672
          FlsSector_8: FlsPhysicalSector=FLS_DATA_ARRAY_0_BLOCK_3_S008, FlsSectorIndex=8, FlsSectorStartaddress=32768
          FlsSector_9: FlsPhysicalSector=FLS_DATA_ARRAY_0_BLOCK_3_S009, FlsSectorIndex=9, FlsSectorStartaddress=36864
    FlsGeneral:
      FlsAbortTimeout = 32767
      FlsAcLoadOnJobStart = 0
      FlsAsyncEraseTimeout = 2147483647
      FlsAsyncWriteTimeout = 2147483647
      FlsBaseAddress = 0
      FlsBlankCheckApi = 0
      FlsCancelApi = 1
      FlsCleanCacheAfterLoadAc = 0
      FlsCompareApi = 1
      FlsDevErrorDetect = 1
      FlsDriverIndex = 0
      FlsECCCheck = 0
      FlsECCHandlingProtectionHook = 0
      FlsEnableDevAssert = 0
      FlsEraseVerificationEnabled = 0
      FlsGetJobResultApi = 1
      FlsGetStatusApi = 1
      FlsMaxEraseBlankCheck = 256
      FlsQspiAsyncEraseTimeout = 2147483647
      FlsQspiAsyncWriteTimeout = 2147483647
      FlsQspiCommandCompleteTimeout = 1
      FlsQspiFlashInitTimeout = 1
      FlsQspiIpTimeoutOsifCounterType = OSIF_COUNTER_DUMMY
      FlsQspiResetTimeout = 1
      FlsQspiSoftwareResetDelay = 0
      FlsQspiSyncEraseTimeout = 2147483647
      FlsQspiSyncReadTimeout = 2147483647
      FlsQspiSyncWriteTimeout = 2147483647
      FlsQspiTxBufferResetDelay = 0
      FlsQspiWriteEnableRetries = 3
      FlsSetModeApi = 1
      FlsSyncEraseTimeout = 2147483647
      FlsSyncWriteTimeout = 2147483647
      FlsTimeoutMethod = OSIF_COUNTER_DUMMY
      FlsTimeoutSupervisionEnabled = 0
      FlsTotalSize = 0
      FlsUseInterrupts = 0
      FlsVersionInfoApi = 1
      FlsWriteVerificationEnabled = 0
    FlsPublishedInformation:
      FlsAcLocationErase = 0
      FlsAcLocationWrite = 0
      FlsAcSizeErase = 0
      FlsAcSizeWrite = 0
      FlsECCValue = 1427461397
      FlsEraseTime = 5.0
      FlsErasedValue = 4294967295
      FlsExpectedHwId = 0
      FlsSpecifiedEraseCycles = 100000
      FlsWriteTime = 5.0E-4
package /Resource
  module config Resource
    CommonPublishedInformation:
      ArReleaseMajorVersion = 4
      ArReleaseMinorVersion = 4
      ArReleaseRevisionVersion = 0
      ModuleId = 0
      SwMajorVersion = 1
      SwMinorVersion = 0
      SwPatchVersion = 1
      VendorId = 43
    ResourceGeneral: ResourceSubderivative=s32k148_lqfp176
package /I2c
  module config I2c: implementation-config-variant=VARIANT-POST-BUILD
    CommonPublishedInformation:
      ArReleaseMajorVersion = 4
      ArReleaseMinorVersion = 4
      ArReleaseRevisionVersion = 0
      ModuleId = 255
      SwMajorVersion = 1
      SwMinorVersion = 0
      SwPatchVersion = 1
      VendorApiInfix = 
      VendorId = 43
    GeneralConfiguration:
      I2cDevErrorDetect = 1
      I2cDisableDemReportErrorStatus = 0
      I2cDmaTransferErrorDetect = 0
      I2cDmaUsed = 0
      I2cEnableUserModeSupport = 0
      I2cFlexIOUsed = 0
      I2cMulticoreSupport = 0
      I2cTimeoutDuration = 65535
      I2cTimeoutMethod = OSIF_COUNTER_DUMMY
      I2cVersionInfoApi = 1
    I2cGlobalConfig
      I2cChannel_0 (I2cChannel): I2cChannelId=0, I2cHwChannel=LPI2C_0, I2cMasterSlaveConfiguration=MASTER_MODE, I2cOperatingMode=LPI2C_STANDARD_MODE
        I2cFlexIOConfiguration: I2cAsyncMethod=FLEXIO_I2C_USING_INTERRUPTS, I2cBaudRate=0.0, I2cFlexIOCompareValue=8, SclFlexioRef=(unset), SdaFlexioRef=(unset)
        I2cMasterConfiguration:
          I2cAsyncMethod = LPI2C_USING_INTERRUPTS
          I2cBaudRate = 100000.0
          I2cBusIdleTimeout = 0
          I2cClockHighPeriod = 38
          I2cClockLowPeriod = 38
          I2cDataValidDelay = 1
          I2cGlitchFilterSCL = 0
          I2cGlitchFilterSDA = 0
          I2cPinLowTimeout = 0
          I2cPrescaler = LPI2C_MASTER_PRESC_DIV_1
          I2cSetupHoldDelay = 38
          I2cClockRef = McuClockReferencePoint_SIRC_CLK
          I2cHighSpeedModeConfiguration: I2cClockHighPeriod=1, I2cClockLowPeriod=3, I2cDataValidDelay=1, I2cHighSpeedBaudRate=0.0, I2cMasterCode=0, I2cSetupHoldDelay=2
        I2cSlaveConfiguration:
          I2cAsyncMethod = LPI2C_USING_INTERRUPTS
          I2cGlitchFilterSCL = 0
          I2cGlitchFilterSDA = 0
          I2cSlaveAddress = 0
          I2cSlaveFilterEnable = 1
          I2cSlaveIs10BitAddress = 0
          Lpi2cSlaveListening = 0
      I2cFlexIOModuleConfiguration
package /I2s
  module config I2s: implementation-config-variant=VARIANT-POST-BUILD
    CommonPublishedInformation:
      ArReleaseMajorVersion = 4
      ArReleaseMinorVersion = 4
      ArReleaseRevisionVersion = 0
      ModuleId = 255
      SwMajorVersion = 1
      SwMinorVersion = 0
      SwPatchVersion = 1
      VendorApiInfix = 
      VendorId = 43
    GeneralConfiguration:
      I2sDevErrorDetect = 1
      I2sEnableUserModeSupport = 0
      I2sMulticoreSupport = 0
      I2sNumLogicChn = 4
      I2sTimeoutMethod = OSIF_COUNTER_DUMMY
      I2sTimeoutVal = 50000
      I2sVersionInfoApi = 1
      I2sFlexioSupport: FlexioI2sDmaFeature=0, FlexioI2sIpDevErrorDetect=1, I2sFlexioI2sEnable=0
      I2sSaiSupport:
        I2sSaiEnable = 1
        SaiAutoDisableClockFeature = 1
        SaiBitClkSwapSupport = 0
        SaiDmaFeature = 0
        SaiEnableDataMasking = 0
        SaiFifoPackFeature = 0
        SaiIpDevErrorDetect = 1
    I2sClockReferencePoint_0 (I2sClockReferencePoint): I2sClockReference=McuClockReferencePoint_BUS_CLK
    I2sConfigSet
      I2sConfiguration_0 (I2sConfiguration): index=0, I2sCallback=NULL_PTR, I2sIpType=SAI, I2sLogicalChannelId=0, I2sModuleRef=SaiHwConfiguration_0
      SaiHwConfiguration_0 (SaiHwConfiguration):
        index = 0
        SaiBitClkInput = 0
        SaiBitClkNegPolar = 1
        SaiBitClkSwap = 0
        SaiBufferAccessSize = 4
        SaiChannelMode = MASK_TRISTATE
        SaiContOnErr = 1
        SaiDataLine0 = 0
        SaiDataLine1 = 1
        SaiDataLine2 = 0
        SaiDataLine3 = 0
        SaiDataLineCount = 2
        SaiElementSize = 2
        SaiEnableDebug = 0
        SaiFifoPackEnable = 0
        SaiFirstBitIndex = 15
        SaiFrameSize = 2
        SaiFrameStartReport = 0
        SaiInstanceId = 1
        SaiMasterClkSrc = BUS_CLK
        SaiMode = Master
        SaiMsbFirst = MSB
        SaiMuxMode = MUX_DISABLED
        SaiRunErrorReport = 0
        SaiSampleRate = 768000
        SaiSyncEarly = 1
        SaiSyncErrorReport = 0
        SaiSyncNegPolar = 1
        SaiSyncOnDemand = 1
        SaiSyncType = ASYNC
        SaiSyncWidth = 16
        SaiTransferType = INTERRUPT
        SaiTxRxConfiguration = Transmitter
        SaiWord0Width = 16
        SaiWordFlagIndex = 0
        SaiWordNWidth = 16
        SaiClkSrcRef = I2sClockReferencePoint_0
package /Spi
  module config Spi: implementation-config-variant=VARIANT-PRE-COMPILE
    CommonPublishedInformation:
      ArReleaseMajorVersion = 4
      ArReleaseMinorVersion = 4
      ArReleaseRevisionVersion = 0
      ModuleId = 83
      SwMajorVersion = 1
      SwMinorVersion = 0
      SwPatchVersion = 1
      VendorId = 43
    SpiAutosarExt:
      SpiAllowBigSizeCollections = 0
      SpiDisableDemReportErrorStatus = 0
      SpiEnableDmaFastTransferSupport = 0
      SpiEnableHWUnitAsyncMode = 1
      SpiEnableUserModeSupport = 0
      SpiFlexioEnable = 0
      SpiHalfDuplexModeSupport = 0
      SpiJobStartNotificationEnable = 0
    SpiDriver
      SpiChannel_MCU_SBC (SpiChannel): SpiChannelId=0, SpiChannelType=EB, SpiDataWidth=8, SpiDefaultData=255, SpiEbMaxLength=2, SpiIbNBuffers=1, SpiTransferStart=MSB
      SpiChannel_MCU_SOC (SpiChannel): SpiChannelId=1, SpiChannelType=EB, SpiDataWidth=8, SpiEbMaxLength=2, SpiIbNBuffers=1, SpiTransferStart=MSB
      SpiExternalDevice_MCU_SBC (SpiExternalDevice):
        SpiBaudrate = 100000.0
        SpiCsContinous = FALSE
        SpiCsIdentifier = PCS3
        SpiCsPolarity = HIGH
        SpiDataShiftEdge = LEADING
        SpiDeviceHalfDuplexSupport = 0
        SpiEnableCs = 1
        SpiHwUnit = CSIB0
        SpiShiftClockIdleLevel = LOW
        SpiTimeClk2Cs = 1.0E-6
        SpiTimeCs2Clk = 1.0E-6
        SpiTimeCs2Cs = 6.4E-6
      SpiExternalDevice_MCU_SOC (SpiExternalDevice):
        SpiBaudrate = 100000.0
        SpiCsContinous = TRUE
        SpiCsIdentifier = PCS2
        SpiCsPolarity = HIGH
        SpiDataShiftEdge = LEADING
        SpiDeviceHalfDuplexSupport = 0
        SpiEnableCs = 1
        SpiHwUnit = CSIB1
        SpiShiftClockIdleLevel = HIGH
        SpiTimeClk2Cs = 1.0E-6
        SpiTimeCs2Clk = 1.0E-6
        SpiTimeCs2Cs = 6.4E-6
      SpiJob_0 (SpiJob): SpiJobId=0, SpiJobPriority=0, SpiDeviceAssignment=SpiExternalDevice_MCU_SBC
        SpiChannelList_0 (SpiChannelList): SpiChannelIndex=0, SpiChannelAssignment=SpiChannel_MCU_SBC
      SpiJob_1 (SpiJob): SpiJobId=1, SpiJobPriority=0, SpiDeviceAssignment=SpiExternalDevice_MCU_SOC
        SpiChannelList_0 (SpiChannelList): SpiChannelIndex=0, SpiChannelAssignment=SpiChannel_MCU_SOC
      SpiSequence_MCU_SBC (SpiSequence): SpiEnableDmaFastTransfer=0, SpiInterruptibleSequence=1, SpiSequenceId=0, SpiJobAssignment=SpiJob_0
      SpiSequence_MCU_SOC (SpiSequence): SpiEnableDmaFastTransfer=0, SpiInterruptibleSequence=1, SpiSequenceId=1, SpiJobAssignment=SpiJob_1
    SpiGeneral:
      SpiCancelApi = 1
      SpiChannelBuffersAllowed = 2
      SpiDevErrorDetect = 1
      SpiGlobalDmaEnable = 0
      SpiHwStatusApi = 1
      SpiInterruptibleSeqAllowed = 1
      SpiLevelDelivered = 1
      SpiMulticoreSupport = 0
      SpiSupportConcurrentSyncTransmit = 0
      SpiTimeoutMethod = OSIF_COUNTER_DUMMY
      SpiTransmitTimeout = 50000
      SpiVersionInfoApi = 1
      SpiPhyUnit_0 (SpiPhyUnit):
        SpiPhyUnitAsyncUseDma = 0
        SpiPhyUnitMapping = LPSPI_1
        SpiPhyUnitMode = SPI_MASTER
        SpiPhyUnitSync = 0
        SpiPinConfiguration = 0
        SpiSamplePoint = 0
        SpiPhyUnitClockRef = McuClockReferencePoint_SPLLDIV2_CLK
      SpiPhyUnit_1 (SpiPhyUnit):
        SpiPhyUnitAsyncUseDma = 0
        SpiPhyUnitMapping = LPSPI_2
        SpiPhyUnitMode = SPI_SLAVE
        SpiPhyUnitSync = 0
        SpiPinConfiguration = 0
        SpiSamplePoint = 0
        SpiPhyUnitClockRef = McuClockReferencePoint_SPLLDIV2_CLK
    SpiPublishedInformation: SpiMaxHwUnit=0
package /Wdg_43_Instance1
  module config Wdg: implementation-config-variant=VARIANT-LINK-TIME
    CommonPublishedInformation:
      ArReleaseMajorVersion = 4
      ArReleaseMinorVersion = 4
      ArReleaseRevisionVersion = 0
      ModuleId = 102
      SwMajorVersion = 1
      SwMinorVersion = 0
      SwPatchVersion = 1
      VendorApiInfix = Instance1
      VendorId = 43
    WdgClockReferencePoint_0 (WdgClockReferencePoint): WdgClockReference=McuClockReferencePoint_LPO128K_CLK
    WdgGeneral:
      WdgCallbackNotification = NULL_PTR
      WdgDevErrorDetect = 1
      WdgDisableAllowed = 0
      WdgEnableDirectService = 0
      WdgEnableMultiCoreSupport = 0
      WdgEnableUserModeSupport = 0
      WdgIndex = 1
      WdgInitialTimeout = 0.02
      WdgMaxTimeout = 10.0
      WdgOsifTimeoutVal = 100000
      WdgRunArea = ROM
      WdgTimeoutMethod = OSIF_COUNTER_DUMMY
      WdgTriggerLocation = NULL_PTR
      WdgVersionInfoApi = 1
      AutosarExt: WdgDisableDemReportErrorStatus=1
    WdgPublishedInformation: WdgTriggerMode=WDG_BOTH
    WdgSettingsConfig: WdgDefaultMode=WDGIF_SLOW_MODE, WdgInstance=EWM, WdgInterruptContentEnable=1, WdgExternalTriggerCounterRef=GptChannelConfiguration_WdgTrig_43
      WdgSettingsConfiguration:
        WdgAssertLogic = Assert_Disabled
        WdgClockValue = 128
        WdgInterruptEnable = 1
        WdgPrescalerValue = 100
        WdgTimeoutPeriod = 0.002
        WdgWindowMode = 0
        WdgWindowPeriod = 0.0
        WdgClkSrcRef = Wdg/WdgClockReferencePoint_0
      WdgSettingsFast
      WdgSettingsOff
      WdgSettingsSlow
package /Can
  module config Can: implementation-config-variant=VARIANT-POST-BUILD
    CanConfigSet
      CanController_CAN0 (CanController):
        index = 0
        CanAutoBusOffRecovery = 0
        CanBusoffProcessing = INTERRUPT
        CanClockFromBus = 0
        CanControllerActivation = 1
        CanControllerBaseAddress = 0
        CanControllerEdgeFilter = 0
        CanControllerFdISO = 1
        CanControllerId = 0
        CanControllerPrExcEn = 0
        CanFDErrorNotification = NULL_PTR
        CanHwChannel = FLEXCAN_0
        CanLoopBackMode = 0
        CanRxProcessing = INTERRUPT
        CanTrippleSamplingEnable = 0
        CanTxProcessing = INTERRUPT
        CanWakeupFunctionalityAPI = 0
        CanWakeupProcessing = POLLING
        CanWakeupSupport = 0
        CanControllerDefaultBaudrate = CanController_CAN0/CanControllerBaudrateConfig_0
        CanCpuClockRef = McuClockReferencePoint_SOSCDIV2_CLK
        CanCpuClockRefAlternate = (unset)
        CanControllerBaudrateConfig_0 (CanControllerBaudrateConfig):
          CanAdvancedSetting = 0
          CanBaudrateTypeSuport = NORMAL_CBT
          CanBusLength = 40
          CanControllerBaudRate = 20.0
          CanControllerBaudRateConfigID = 0
          CanControllerPrescaller = 10
          CanControllerPrescallerAlternate = 10
          CanControllerPropSeg = 5
          CanControllerSeg1 = 5
          CanControllerSeg2 = 6
          CanControllerSyncJumpWidth = 1
          CanControllerSyncSeg = 1
          CanPropDelayTranceiver = 150.0
          CanTxArbitrationStartDelay = 12
        CanRxFiFo
          CanRxFiFo (CanLegacyFiFo):
            CanFiFoDmaErrorNotif = NULL_PTR
            CanFiFoOverflowNotif = NULL_PTR
            CanFiFoWarnNotif = NULL_PTR
            CanIdAcceptanceMode = FORMAT_A
            CanLegacyFIFOGlobalMask{0..3} = 0
            CanLegacyFiFoDmaEnable = 0
      CanController_CAN1 (CanController):
        index = 1
        CanAutoBusOffRecovery = 0
        CanBusoffProcessing = INTERRUPT
        CanClockFromBus = 0
        CanControllerActivation = 1
        CanControllerBaseAddress = 0
        CanControllerEdgeFilter = 0
        CanControllerFdISO = 1
        CanControllerId = 1
        CanControllerPrExcEn = 0
        CanFDErrorNotification = NULL_PTR
        CanHwChannel = FLEXCAN_1
        CanLoopBackMode = 0
        CanRxProcessing = INTERRUPT
        CanTrippleSamplingEnable = 0
        CanTxProcessing = INTERRUPT
        CanWakeupFunctionalityAPI = 0
        CanWakeupProcessing = POLLING
        CanWakeupSupport = 0
        CanControllerDefaultBaudrate = CanController_CAN1/CanControllerBaudrateConfig_0
        CanCpuClockRef = McuClockReferencePoint_SOSCDIV2_CLK
        CanCpuClockRefAlternate = (unset)
        CanControllerBaudrateConfig_0 (CanControllerBaudrateConfig):
          CanAdvancedSetting = 0
          CanBaudrateTypeSuport = NORMAL_CBT
          CanBusLength = 40
          CanControllerBaudRate = 500.0
          CanControllerBaudRateConfigID = 0
          CanControllerPrescaller = 1
          CanControllerPrescallerAlternate = 10
          CanControllerPropSeg = 6
          CanControllerSeg1 = 5
          CanControllerSeg2 = 4
          CanControllerSyncJumpWidth = 4
          CanControllerSyncSeg = 1
          CanPropDelayTranceiver = 150.0
          CanTxArbitrationStartDelay = 12
        CanRxFiFo
          CanRxFiFo (CanLegacyFiFo):
            CanFiFoDmaErrorNotif = NULL_PTR
            CanFiFoOverflowNotif = NULL_PTR
            CanFiFoWarnNotif = NULL_PTR
            CanIdAcceptanceMode = FORMAT_A
            CanLegacyFIFOGlobalMask{0..3} = 0
            CanLegacyFiFoDmaEnable = 0
      4 x CanHardwareObject, all with CanHandleType=BASIC, CanIdType=STANDARD, CanTimeStampEnable=0:
        CanHardwareObject_CAN0_RX: index=0, CanHwObjectCount=6, CanObjectId=0, CanObjectType=RECEIVE, CanControllerRef=CanController_CAN0
          8 x CanHwFilter, all with CanHwFilterCode=0, CanHwFilterMask=0:
            CanHwFilter_{0..7}: index={0..7}
        CanHardwareObject_CAN1_RX: index=1, CanHwObjectCount=6, CanObjectId=1, CanObjectType=RECEIVE, CanControllerRef=CanController_CAN1
          8 x CanHwFilter, all with CanHwFilterCode=0, CanHwFilterMask=0:
            CanHwFilter_{0..7}: index={0..7}
        CanHardwareObject_CAN0_TX: index=2, CanHwObjectCount=1, CanObjectId=2, CanObjectType=TRANSMIT, CanControllerRef=CanController_CAN0
        CanHardwareObject_CAN1_TX: index=3, CanHwObjectCount=1, CanObjectId=3, CanObjectType=TRANSMIT, CanControllerRef=CanController_CAN1
    CanGeneral:
      CanDevErrorDetect = 0
      CanEnableDualClockMode = 0
      CanEnableUserModeSupport = 0
      CanIndex = 0
      CanMBCountExtensionSupport = 0
      CanMainFunctionModePeriod = 0.001
      CanMulticoreSupport = 0
      CanMultiplexedTransmission = 1
      CanPublicIcomSupport = 0
      CanTimeoutDuration = 0.1
      CanTimeoutMethod = OSIF_COUNTER_DUMMY
      CanVersionInfoApi = 0
      CanSupportTTCANRef = (unset)
      CanMainFunctionRWPeriods_0 (CanMainFunctionRWPeriods): index=0, CanMainFunctionPeriod=0.001
    CommonPublishedInformation:
      ArReleaseMajorVersion = 4
      ArReleaseMinorVersion = 4
      ArReleaseRevisionVersion = 0
      ModuleId = 80
      SwMajorVersion = 1
      SwMinorVersion = 0
      SwPatchVersion = 1
      VendorApiInfix = 
      VendorId = 43
package /Adc
  module config Adc: implementation-config-variant=VARIANT-POST-BUILD
    AdcConfigSet
      AdcHwUnit_ADC0 (AdcHwUnit):
        index = 0
        AdcAltPrescale = 2
        AdcCalibrationPrescale = 8
        AdcHwUnitId = ADC0
        AdcHwUnitResolution = RESOLUTION_12
        AdcHwUnitUsrGain = 4
        AdcHwUnitUsrOffset = 0
        AdcLogicalUnitId = 0
        AdcTransferType = ADC_INTERRUPT
        4 x AdcChannel:
          TANK_MCU_2_DETECT_IN: index=0, AdcChannelId=2, AdcChannelName=SE2_ADCH2, AdcLogicalChannelId=0
          TANK_MCU_1_DETECT_IN: index=1, AdcChannelId=3, AdcChannelName=SE3_ADCH3, AdcLogicalChannelId=1
          VBAT_ALL_MUX: index=2, AdcChannelId=33, AdcChannelName=SE17_ADCH33, AdcLogicalChannelId=2
          VBAT_MB_MUX: index=3, AdcChannelId=34, AdcChannelName=SE18_ADCH34, AdcLogicalChannelId=3
        ADC0 (AdcGroup):
          index = 0
          AdcDelayNextPdb = 0
          AdcEnableChDisableChGroup = 0
          AdcEnableHalfInterrupt = 0
          AdcEnableOptimizeDmaStreamingGroups = 0
          AdcExtDMAChanEnable = 0
          AdcExtraNotification = NULL_PTR
          AdcGroupAccessMode = ADC_ACCESS_MODE_SINGLE
          AdcGroupConversionMode = ADC_CONV_MODE_ONESHOT
          AdcGroupConversionType = ADC_CONV_TYPE_NORMAL
          AdcGroupId = 0
          AdcGroupInBacktoBackMode = 1
          AdcGroupTriggSrc = ADC_TRIGG_SRC_SW
          AdcGroupUsesChannelDelays = 0
          AdcPdbPeriodContinuousMode = 1000
          AdcStreamResultGroup = 0
          AdcStreamingBufferMode = ADC_STREAM_BUFFER_LINEAR
          AdcStreamingNumSamples = 1
          AdcWithoutDma = 0
          AdcWithoutInterrupts = 0
          AdcGroupDefinition = TANK_MCU_2_DETECT_IN
          AdcGroupDefinition = TANK_MCU_1_DETECT_IN
          AdcGroupDefinition = VBAT_ALL_MUX
          AdcGroupDefinition = VBAT_MB_MUX
          AdcGroupHwTriggerSource = (unset)
          AdcAlternateGroupConvTimings: AdcGroupAltHardwareAverageEnable=0, AdcGroupAltHardwareAverageSelect=SAMPLES_4, AdcGroupAltSampleTimeDuration=2
          AdcGroupConversionConfiguration: AdcGroupHardwareAverageEnable=0, AdcGroupHardwareAverageSelect=SAMPLES_4, AdcGroupSampleTimeDuration=2
        PdbHwUnit:
          AdcPdbCounterPeriod = 65535
          AdcPdbErrorNotification = NULL_PTR
          AdcPdbMultiplicationFactorSelect = 0
          AdcPdbPrescalerDividerSelect = 0
          PdbInterChnBackToBackEnable = 0
      AdcHwUnit_ADC1 (AdcHwUnit):
        index = 1
        AdcAltPrescale = 2
        AdcCalibrationPrescale = 8
        AdcHwUnitId = ADC1
        AdcHwUnitResolution = RESOLUTION_12
        AdcHwUnitUsrGain = 4
        AdcHwUnitUsrOffset = 0
        AdcLogicalUnitId = 1
        AdcTransferType = ADC_INTERRUPT
        3 x AdcChannel:
          HW_PHASE_ID: index=0, AdcChannelId=34, AdcChannelName=SE18_ADCH34, AdcLogicalChannelId=0
          HW_PHASE_VERSION_ID: index=1, AdcChannelId=35, AdcChannelName=SE19_ADCH35, AdcLogicalChannelId=1
          VBAT_CUR_MONITOR: index=2, AdcChannelId=36, AdcChannelName=SE20_ADCH36, AdcLogicalChannelId=2
        ADC1 (AdcGroup):
          index = 0
          AdcDelayNextPdb = 0
          AdcEnableChDisableChGroup = 0
          AdcEnableHalfInterrupt = 0
          AdcEnableOptimizeDmaStreamingGroups = 0
          AdcExtDMAChanEnable = 0
          AdcExtraNotification = NULL_PTR
          AdcGroupAccessMode = ADC_ACCESS_MODE_SINGLE
          AdcGroupConversionMode = ADC_CONV_MODE_ONESHOT
          AdcGroupConversionType = ADC_CONV_TYPE_NORMAL
          AdcGroupId = 1
          AdcGroupInBacktoBackMode = 1
          AdcGroupTriggSrc = ADC_TRIGG_SRC_SW
          AdcGroupUsesChannelDelays = 0
          AdcPdbPeriodContinuousMode = 1000
          AdcStreamResultGroup = 0
          AdcStreamingBufferMode = ADC_STREAM_BUFFER_LINEAR
          AdcStreamingNumSamples = 1
          AdcWithoutDma = 0
          AdcWithoutInterrupts = 1
          AdcGroupDefinition = HW_PHASE_ID
          AdcGroupDefinition = HW_PHASE_VERSION_ID
          AdcGroupDefinition = VBAT_CUR_MONITOR
          AdcGroupHwTriggerSource = (unset)
          AdcAlternateGroupConvTimings: AdcGroupAltHardwareAverageEnable=0, AdcGroupAltHardwareAverageSelect=SAMPLES_4, AdcGroupAltSampleTimeDuration=2
          AdcGroupConversionConfiguration: AdcGroupHardwareAverageEnable=0, AdcGroupHardwareAverageSelect=SAMPLES_4, AdcGroupSampleTimeDuration=2
        PdbHwUnit:
          AdcPdbCounterPeriod = 65535
          AdcPdbErrorNotification = NULL_PTR
          AdcPdbMultiplicationFactorSelect = 0
          AdcPdbPrescalerDividerSelect = 0
          PdbInterChnBackToBackEnable = 0
    AdcGeneral:
      AdcDeInitApi = 1
      AdcDevErrorDetect = 1
      AdcEnableLimitCheck = 1
      AdcEnableQueuing = 1
      AdcEnableStartStopGroupApi = 1
      AdcGrpNotifCapability = 1
      AdcHwTriggerApi = 0
      AdcPriorityImplementation = ADC_PRIORITY_NONE
      AdcPriorityQueueMaxDepth = 1
      AdcReadGroupApi = 1
      AdcResultAlignment = ADC_ALIGN_RIGHT
      AdcVersionInfoApi = 1
    AdcInterrupt_0 (AdcInterrupt): AdcInterruptEnable=1, AdcInterruptSource=ADC0_COCO
    AdcInterrupt_1 (AdcInterrupt): AdcInterruptEnable=0, AdcInterruptSource=ADC1_COCO
    AdcPublishedInformation: AdcChannelValueSigned=0, AdcGroupFirstChannelFixed=0, AdcMaxChannelResolution=12
    AutosarExt:
      AdcBypassAbortChainCheck = 0
      AdcContinuousWithoutInterrupt = 0
      AdcConvTimeOnce = 0
      AdcEnableCalibration = 0
      AdcEnableChDisableChApi = 0
      AdcEnableDmaTransferMode = 0
      AdcEnableDualClockMode = 0
      AdcEnableGroupDependentChannelNames = 0
      AdcEnableGroupStreamingResultReorder = 0
      AdcEnableInitialNotification = 0
      AdcEnablePdbInterChannelBackToBackSupport = 0
      AdcEnableReadRawDataApi = 0
      AdcEnableSetChannel = 0
      AdcEnableSimSupplyMonitor = 0
      AdcEnableUserModeSupport = 0
      AdcIpDevErrorDetect = 0
      AdcMulticoreSupport = 0
      AdcOptimizeDmaStreamingGroups = 0
      AdcOptimizeOneShotHwTriggerConversions = 0
      AdcTimeoutMethod = OSIF_COUNTER_DUMMY
      AdcTimeoutVal = 100000
      PdbIpDevErrorDetect = 0
    CommonPublishedInformation:
      ArReleaseMajorVersion = 4
      ArReleaseMinorVersion = 4
      ArReleaseRevisionVersion = 0
      ModuleId = 123
      SwMajorVersion = 1
      SwMinorVersion = 0
      SwPatchVersion = 1
      VendorApiInfix = 
      VendorId = 43
package /Pwm
  module config Pwm: implementation-config-variant=VARIANT-POST-BUILD
    CommonPublishedInformation:
      ArReleaseMajorVersion = 4
      ArReleaseMinorVersion = 4
      ArReleaseRevisionVersion = 0
      ModuleId = 121
      SwMajorVersion = 1
      SwMinorVersion = 0
      SwPatchVersion = 1
      VendorId = 43
    PwmChannelConfigSet
      KBD_PWM_1 (PwmChannel):
        index = 0
        PwmChannelId = 0
        PwmDutycycleDefault = 16384
        PwmIdleState = PWM_LOW
        PwmPeriodDefault = 32768.0
        PwmPeriodInTicks = 1
        PwmPolarity = PWM_HIGH
        PwmHwChannel = PwmFtm_5/KBD_PWM_1
        PwmMcuClockReferencePoint = McuClockReferencePoint_SYS_CLK
      KBD_PWM_2 (PwmChannel):
        index = 1
        PwmChannelId = 1
        PwmDutycycleDefault = 16384
        PwmIdleState = PWM_LOW
        PwmPeriodDefault = 32768.0
        PwmPeriodInTicks = 1
        PwmPolarity = PWM_HIGH
        PwmHwChannel = PwmFtm_5/KBD_PWM_2
        PwmMcuClockReferencePoint = McuClockReferencePoint_SYS_CLK
      PwmFtm_5 (PwmFtm): index=0, PwmHwInstance=Ftm_5
        FtmGlobalFaultCfg: FtmFaultFilterValue=0, FtmFaultFunctionality=FAULT_DISABLED, FtmFaultIrqUsed=0, FtmFaultOutputState=SAFE_VALUE
        KBD_PWM_1 (PwmFtmCh):
          index = 0
          PwmFtmChDutyCycle = 0
          PwmFtmChDutyCycleDither = 0
          PwmFtmChExternTriggerEnable = 0
          PwmFtmChId = CH_4
          PwmFtmChInitOutput = LOW
          PwmFtmChInterrupt = 0
          PwmFtmChMatchLoadPointEnable = 0
          PwmFtmChPolarity = Channel_active_HIGH
          PwmFtmChPulseType = High_true_pulse
          PwmFtmChPwmOutputEnable = 1
          PwmFtmChSwCtrlEnable = 0
          PwmFtmChSwCtrlValue = 0
          PwmFtmPairChEnable = 0
          PwmFtmChInterruptCallback: PwmFtmChInterruptFunctionCallback=NULL_PTR, PwmFtmChInterruptParameterCallback=NULL_PTR
          PwmFtmPairedCh:
            PwmFtmDutyDitheringPaired = 0
            PwmFtmPairedChCombineMode = Combine_modes_disabled
            PwmFtmPairedChComplementary = 0
            PwmFtmPairedChComplementaryMode = Invert_Output
            PwmFtmPairedChDeadtimeEnable = 0
            PwmFtmPairedChExtTrig = 0
            PwmFtmPairedChPhaseShift = 0
            PwmFtmPairedChSync = 1
        KBD_PWM_2 (PwmFtmCh):
          index = 1
          PwmFtmChDutyCycle = 0
          PwmFtmChDutyCycleDither = 0
          PwmFtmChExternTriggerEnable = 0
          PwmFtmChId = CH_6
          PwmFtmChInitOutput = LOW
          PwmFtmChInterrupt = 0
          PwmFtmChMatchLoadPointEnable = 0
          PwmFtmChPolarity = Channel_active_HIGH
          PwmFtmChPulseType = High_true_pulse
          PwmFtmChPwmOutputEnable = 1
          PwmFtmChSwCtrlEnable = 0
          PwmFtmChSwCtrlValue = 0
          PwmFtmPairChEnable = 0
          PwmFtmChInterruptCallback: PwmFtmChInterruptFunctionCallback=NULL_PTR, PwmFtmChInterruptParameterCallback=NULL_PTR
          PwmFtmPairedCh:
            PwmFtmDutyDitheringPaired = 0
            PwmFtmPairedChCombineMode = Combine_modes_disabled
            PwmFtmPairedChComplementary = 0
            PwmFtmPairedChComplementaryMode = Invert_Output
            PwmFtmPairedChDeadtimeEnable = 0
            PwmFtmPairedChExtTrig = 0
            PwmFtmPairedChPhaseShift = 0
            PwmFtmPairedChSync = 1
        PwmFtmClkCfg: PwmFtmClockPrescaler=Divide_by_1, PwmFtmClockPrescalerAlternate=Divide_by_1, PwmFtmClockSource=System_clock
        PwmFtmGlobalChCfg: PwmFtmCounterMode=Edge_Aligned_mode, PwmFtmDeadTime=0, PwmFtmDeadTimePrescaler=Divide_by_1, PwmFtmPeriod=1, PwmFtmPeriodDither=0
        PwmFtmInstCfg:
          PwmFtmDebugMode = Debug_Mode_00
          PwmFtmInitTrigger = 0
          PwmFtmInitTriggerMode = Trigger_on_Reload_Point
          PwmFtmOverflowIrq = 0
          PwmFtmReloadIrq = 0
          PwmFtmWriteProtection = 0
          PwmFtmOverflowIrqCallback: PwmFtmOverflowIrqFunctionCallback=NULL_PTR, PwmFtmOverflowIrqParameterCallback=NULL_PTR
          PwmFtmReloadIrqCallback: PwmFtmReloadIrqFunctionCallback=NULL_PTR, PwmFtmReloadIrqParameterCallback=NULL_PTR
        PwmFtmSyncCfg:
          PwmFtmAutoHwTrig = 0
          PwmFtmCounterInitial = Sync_on_FTM_Sync_Trigger
          PwmFtmCounterSync = Sync_on_FTM_Sync_Trigger
          PwmFtmHalfCycleLoadPoint = 0
          PwmFtmHwTrig{0..2} = 0
          PwmFtmInvertControl = Sync_disabled
          PwmFtmMaxLoadPoint = 0
          PwmFtmMinLoadPoint = 0
          PwmFtmOutputMask = Sync_disabled
          PwmFtmReloadPointFrequency = 0
          PwmFtmSwOutControl = Sync_disabled
          PwmFtmSyncMode = Software_sync_trigger
    PwmConfigurationOfOptApiServices:
      PwmDeInitApi = 1
      PwmDisableTrigger = 0
      PwmEnableTrigger = 0
      PwmForceOutputToZeroApi = 0
      PwmGetChannelStateApi = 0
      PwmGetOutputState = 0
      PwmResetCounter = 0
      PwmSetChannelDeadTime = 0
      PwmSetDutyCycle = 1
      PwmSetDutyCycle_NoUpdate = 0
      PwmSetDutyPhaseShift = 0
      PwmSetOutputToIdle = 0
      PwmSetPeriodAndDuty = 1
      PwmSetPeriodAndDuty_NoUpdate = 0
      PwmSetPhaseShift = 0
      PwmSetPhaseShift_NoUpdate = 0
      PwmVersionInfoApi = 1
    PwmGeneral:
      PwmDevErrorDetect = 1
      PwmDutycycleUpdatedEndperiod = 0
      PwmEnableDualClockMode = 0
      PwmEnableExternalTrigger = 0
      PwmEnableMaskOutputs = 0
      PwmEnablePhaseShift = 0
      PwmEnableUserModeSupport = 0
      PwmFaultSupported = 0
      PwmIndex = 0
      PwmMultiChannelSync = 0
      PwmMulticoreEnabled = 0
      PwmNotificationSupported = 0
      PwmPeriodUpdatedEndperiod = 1
package /Dio
  module config Dio: implementation-config-variant=VARIANT-PRE-COMPILE
    CommonPublishedInformation:
      ArReleaseMajorVersion = 4
      ArReleaseMinorVersion = 4
      ArReleaseRevisionVersion = 0
      ModuleId = 120
      SwMajorVersion = 1
      SwMinorVersion = 0
      SwPatchVersion = 1
      VendorId = 43
    DioConfig
      5 x DioPort:
        DioPort_A: DioPortId=0
          13 x DioChannel:
            DioChannel_BRAKE_OIL_LEVEL_ALARM_IN: DioChannelId=17
            DioChannel_BREAK_SHOE_ALARM1_IN: DioChannelId=15
            DioChannel_BREAK_SHOE_ALARM2_IN: DioChannelId=16
            DioChannel_BSTON: DioChannelId=25
            DioChannel_DSI0_1V0_PGOOD: DioChannelId=24
            DioChannel_EXT_3V3_PGOOD: DioChannelId=22
            DioChannel_FAN_PGOOD: DioChannelId=20
            DioChannel_MCU_POWER_ON_LED: DioChannelId=14
            DioChannel_MCU_SOC_FAULT_IN: DioChannelId=9
            DioChannel_OVER_VOL_FLAG: DioChannelId=19
            DioChannel_PA_PGOOD: DioChannelId=23
            DioChannel_SYS_3V3_PGOOD: DioChannelId=21
            DioChannel_UNDER_VOL_FLAG: DioChannelId=18
        DioPort_B: DioPortId=1
          10 x DioChannel:
            DioChannel_ALL_OP_SHDN: DioChannelId=13
            DioChannel_DISP_CENTER_INT: DioChannelId=24
            DioChannel_DISP_CLUSTER_INT: DioChannelId=26
            DioChannel_DISP_PASSENGER_INT: DioChannelId=19
            DioChannel_DISP_RIGHT_INT: DioChannelId=30
            DioChannel_ETH_WAKE_UP_DETECT: DioChannelId=31
            DioChannel_FAN_PWR_IN: DioChannelId=12
            DioChannel_FIR_AVDD12_EXT_PGOOD: DioChannelId=23
            DioChannel_IGN_INPUT_DETECT: DioChannelId=11
            DioChannel_PHY_0V9_PGOOD: DioChannelId=22
        DioPort_C: DioPortId=2
          14 x DioChannel:
            DioChannel_ACC_SENSOR_FSYNC: DioChannelId=27
            DioChannel_ACC_SENSOR_INT1: DioChannelId=28
            DioChannel_ACC_SENSOR_INT2: DioChannelId=29
            DioChannel_EXT1_1V8_PGOOD: DioChannelId=18
            DioChannel_EXT2_1V8_PGOOD: DioChannelId=21
            DioChannel_KBD_PWM_1_EN: DioChannelId=22
            DioChannel_KBD_PWM_1_FAULT: DioChannelId=24
            DioChannel_KBD_PWM_2_EN: DioChannelId=25
            DioChannel_KBD_PWM_2_FAULT: DioChannelId=26
            DioChannel_MCU_MAX20030_EN1: DioChannelId=10
            DioChannel_MCU_MAX20030_EN2: DioChannelId=11
            DioChannel_MCU_MAX20030_EN3: DioChannelId=12
            DioChannel_MCU_MAX20030_EN4: DioChannelId=13
            DioChannel_SYS_1V8_PGOOD: DioChannelId=20
        DioPort_D: DioPortId=3
          14 x DioChannel:
            DioChanne_A2B_PGOOD: DioChannelId=25
            DioChanne_AUDIO_PA_FAULT: DioChannelId=14
            DioChanne_CSI0_1V2_PGOOD: DioChannelId=28
            DioChanne_CSI1_1V2_PGOOD: DioChannelId=27
            DioChanne_CSI2_1V2_PGOOD: DioChannelId=29
            DioChanne_CSI3_1V2_PGOOD: DioChannelId=30
            DioChanne_DISP_LEFT_INT: DioChannelId=21
            DioChanne_MCU_MB_SENSOR_INT: DioChannelId=0
            DioChanne_MCU_RESET_SOC_IN: DioChannelId=3
            DioChanne_MCU_REST_PA: DioChannelId=20
            DioChanne_MCU_TO_SOC_INT_3V3: DioChannelId=2
            DioChanne_SOC_RES_OUT: DioChannelId=13
            DioChanne_SOC_TO_MCU_INT_3V3: DioChannelId=1
            DioChanne_WDOFF_EN: DioChannelId=31
        DioPort_E: DioPortId=4
          14 x DioChannel:
            PortPin_AUDIO_PA1_FAULT: DioChannelId=21
            PortPin_AUDIO_PA1_WARN: DioChannelId=22
            PortPin_AUDIO_PA2_FAULT: DioChannelId=23
            PortPin_AUDIO_PA2_WARN: DioChannelId=24
            PortPin_CHARGE_INT: DioChannelId=20
            PortPin_DSI0_1V2_PGOOD: DioChannelId=26
            PortPin_DSI1_1V2_PGOOD: DioChannelId=27
            PortPin_FAN_ALERT: DioChannelId=11
            PortPin_FAN_FAULT: DioChannelId=10
            PortPin_I2S_PA_SYNC: DioChannelId=2
            PortPin_MCU_CAN0_STB: DioChannelId=3
            PortPin_MCU_HVEN: DioChannelId=19
            PortPin_PA_PWR_EN: DioChannelId=7
            PortPin_SBC_INT: DioChannelId=17
    DioGeneral:
      DioDevErrorDetect = 0
      DioEnableUserModeSupport = 0
      DioFlipChannelApi = 0
      DioMaskedWritePortApi = 0
      DioMulticoreSupport = 0
      DioReadZeroForUndefinedPortPins = 0
      DioReversePortBits = 0
      DioVersionInfoApi = 0
      GPIODioIPDevErrorDetect = 0
package /Mcl
  module config Mcl: implementation-config-variant=VARIANT-POST-BUILD, post-build-variant-used=true
    CommonPublishedInformation:
      ArReleaseMajorVersion = 4
      ArReleaseMinorVersion = 4
      ArReleaseRevisionVersion = 0
      ModuleId = 255
      SwMajorVersion = 1
      SwMinorVersion = 0
      SwPatchVersion = 1
      VendorId = 43
    MclConfig
      8 x dmaLogicChannel_Type, all with dmaLogicChannel_EnableGlobalConfig=1, dmaLogicChannel_EnableScatterGather=0, dmaLogicChannel_EnableTransferConfig=0, dmaLogicChannel_ErrorInterruptCallback=NULL_PTR, dmaLogicChannel_HwInstId=DMA_IP_HW_INST_0, dmaLogicChannel_InterruptCallback=NULL_PTR:
        dmaLogicChannel_Spi1_Tx: index=0, dmaLogicChannel_HwChId=DMA_IP_HW_CH_3, dmaLogicChannel_LogicName=DMA_LOGIC_CH_3
          dmaLogicChannel_ConfigType
            dmaLogicChannel_GlobalConfigType
              dmaLogicChannelConfig_GlobalInterruptType: dmaGlobalInterrupt_enDmaErrorInterrupt=0
              dmaLogicChannelConfig_GlobalPriorityType: dmaGlobalPriority_LevelPriority=DMA_IP_LEVEL_PRIO0, dmaGlobalPriority_disPreempt=0, dmaGlobalPriority_enPreemption=0
              dmaLogicChannelConfig_GlobalRequestType:
                dmaGlobalRequest_Dmamux0HwRequest = DMA_IP_REQ_MUX0_DISABLED
                dmaGlobalRequest_enDmaRequest = 0
                dmaGlobalRequest_enDmamuxSource = 0
                dmaGlobalRequest_enDmamuxTrigger = 0
            dmaLogicChannel_ScatterGatherConfigType
            dmaLogicChannel_TransferConfigType
              dmaLogicChannelConfig_TransferControlType:
                dmaLogicChannelConfig_DestinationStoreAddressType = 0U
                dmaLogicChannelConfig_ScatterGatherAddressType = 0U
                dmaLogicChannelConfig_bandwidthControl = DMA_IP_BWC_ENGINE_NO_STALL
                dmaLogicChannelConfig_disDmaAutoHwReq = 0
                dmaLogicChannelConfig_enDmaHalfMajorInterrupt = 0
                dmaLogicChannelConfig_enDmaMajorInterrupt = 0
                dmaLogicChannelConfig_enStart = 0
              dmaLogicChannelConfig_TransferDestinationType:
                dmaLogicChannelConfig_DestinationAddressType = 0
                dmaLogicChannelConfig_DestinationLastAddressAdjustmentType = 0
                dmaLogicChannelConfig_DestinationModuloType = 0
                dmaLogicChannelConfig_DestinationSignedOffsetType = 0
                dmaTransferConfig_TransferSizeType = DMA_IP_TRANSFER_SIZE_1_BYTE
              dmaLogicChannelConfig_TransferMajorLoopType: dmaLogicChannelConfig_MajorLoopCountType=1, dmaLogicChannelConfig_enMajorLoopLinkCh=0
              dmaLogicChannelConfig_TransferMinorLoopType:
                dmaLogicChannelConfig_MinorLoopSizeType = 0
                dmaLogicChannelConfig_OffsetValueType = 0
                dmaLogicChannelConfig_enDestinationOffset = 0
                dmaLogicChannelConfig_enMinorLoopLinkCh = 0
                dmaLogicChannelConfig_enSourceOffset = 0
              dmaLogicChannelConfig_TransferSourceType:
                dmaLogicChannelConfig_SourceAddressType = 0
                dmaLogicChannelConfig_SourceLastAddressAdjustmentType = 0
                dmaLogicChannelConfig_SourceModuloType = 0
                dmaLogicChannelConfig_SourceSignedOffsetType = 0
                dmaTransferConfig_TransferSizeType = DMA_IP_TRANSFER_SIZE_1_BYTE
        dmaLogicChannel_Spi1_Rx: index=1, dmaLogicChannel_HwChId=DMA_IP_HW_CH_2, dmaLogicChannel_LogicName=DMA_LOGIC_CH_2
          dmaLogicChannel_ConfigType
            dmaLogicChannel_GlobalConfigType
              dmaLogicChannelConfig_GlobalInterruptType: dmaGlobalInterrupt_enDmaErrorInterrupt=0
              dmaLogicChannelConfig_GlobalPriorityType: dmaGlobalPriority_LevelPriority=DMA_IP_LEVEL_PRIO1, dmaGlobalPriority_disPreempt=0, dmaGlobalPriority_enPreemption=0
              dmaLogicChannelConfig_GlobalRequestType:
                dmaGlobalRequest_Dmamux0HwRequest = DMA_IP_REQ_MUX0_DISABLED
                dmaGlobalRequest_enDmaRequest = 0
                dmaGlobalRequest_enDmamuxSource = 0
                dmaGlobalRequest_enDmamuxTrigger = 0
            dmaLogicChannel_ScatterGatherConfigType
            dmaLogicChannel_TransferConfigType
              dmaLogicChannelConfig_TransferControlType:
                dmaLogicChannelConfig_DestinationStoreAddressType = 0U
                dmaLogicChannelConfig_ScatterGatherAddressType = 0U
                dmaLogicChannelConfig_bandwidthControl = DMA_IP_BWC_ENGINE_NO_STALL
                dmaLogicChannelConfig_disDmaAutoHwReq = 0
                dmaLogicChannelConfig_enDmaHalfMajorInterrupt = 0
                dmaLogicChannelConfig_enDmaMajorInterrupt = 0
                dmaLogicChannelConfig_enStart = 0
              dmaLogicChannelConfig_TransferDestinationType:
                dmaLogicChannelConfig_DestinationAddressType = 0
                dmaLogicChannelConfig_DestinationLastAddressAdjustmentType = 0
                dmaLogicChannelConfig_DestinationModuloType = 0
                dmaLogicChannelConfig_DestinationSignedOffsetType = 0
                dmaTransferConfig_TransferSizeType = DMA_IP_TRANSFER_SIZE_1_BYTE
              dmaLogicChannelConfig_TransferMajorLoopType: dmaLogicChannelConfig_MajorLoopCountType=1, dmaLogicChannelConfig_enMajorLoopLinkCh=0
              dmaLogicChannelConfig_TransferMinorLoopType:
                dmaLogicChannelConfig_MinorLoopSizeType = 0
                dmaLogicChannelConfig_OffsetValueType = 0
                dmaLogicChannelConfig_enDestinationOffset = 0
                dmaLogicChannelConfig_enMinorLoopLinkCh = 0
                dmaLogicChannelConfig_enSourceOffset = 0
              dmaLogicChannelConfig_TransferSourceType:
                dmaLogicChannelConfig_SourceAddressType = 0
                dmaLogicChannelConfig_SourceLastAddressAdjustmentType = 0
                dmaLogicChannelConfig_SourceModuloType = 0
                dmaLogicChannelConfig_SourceSignedOffsetType = 0
                dmaTransferConfig_TransferSizeType = DMA_IP_TRANSFER_SIZE_1_BYTE
        dmaLogicChannel_Spi2_Tx: index=2, dmaLogicChannel_HwChId=DMA_IP_HW_CH_5, dmaLogicChannel_LogicName=DMA_LOGIC_CH_5
          dmaLogicChannel_ConfigType
            dmaLogicChannel_GlobalConfigType
              dmaLogicChannelConfig_GlobalInterruptType: dmaGlobalInterrupt_enDmaErrorInterrupt=0
              dmaLogicChannelConfig_GlobalPriorityType: dmaGlobalPriority_LevelPriority=DMA_IP_LEVEL_PRIO2, dmaGlobalPriority_disPreempt=0, dmaGlobalPriority_enPreemption=0
              dmaLogicChannelConfig_GlobalRequestType:
                dmaGlobalRequest_Dmamux0HwRequest = DMA_IP_REQ_MUX0_DISABLED
                dmaGlobalRequest_enDmaRequest = 0
                dmaGlobalRequest_enDmamuxSource = 0
                dmaGlobalRequest_enDmamuxTrigger = 0
            dmaLogicChannel_ScatterGatherConfigType
            dmaLogicChannel_TransferConfigType
              dmaLogicChannelConfig_TransferControlType:
                dmaLogicChannelConfig_DestinationStoreAddressType = 0U
                dmaLogicChannelConfig_ScatterGatherAddressType = 0U
                dmaLogicChannelConfig_bandwidthControl = DMA_IP_BWC_ENGINE_NO_STALL
                dmaLogicChannelConfig_disDmaAutoHwReq = 0
                dmaLogicChannelConfig_enDmaHalfMajorInterrupt = 0
                dmaLogicChannelConfig_enDmaMajorInterrupt = 0
                dmaLogicChannelConfig_enStart = 0
              dmaLogicChannelConfig_TransferDestinationType:
                dmaLogicChannelConfig_DestinationAddressType = 0
                dmaLogicChannelConfig_DestinationLastAddressAdjustmentType = 0
                dmaLogicChannelConfig_DestinationModuloType = 0
                dmaLogicChannelConfig_DestinationSignedOffsetType = 0
                dmaTransferConfig_TransferSizeType = DMA_IP_TRANSFER_SIZE_1_BYTE
              dmaLogicChannelConfig_TransferMajorLoopType: dmaLogicChannelConfig_MajorLoopCountType=1, dmaLogicChannelConfig_enMajorLoopLinkCh=0
              dmaLogicChannelConfig_TransferMinorLoopType:
                dmaLogicChannelConfig_MinorLoopSizeType = 0
                dmaLogicChannelConfig_OffsetValueType = 0
                dmaLogicChannelConfig_enDestinationOffset = 0
                dmaLogicChannelConfig_enMinorLoopLinkCh = 0
                dmaLogicChannelConfig_enSourceOffset = 0
              dmaLogicChannelConfig_TransferSourceType:
                dmaLogicChannelConfig_SourceAddressType = 0
                dmaLogicChannelConfig_SourceLastAddressAdjustmentType = 0
                dmaLogicChannelConfig_SourceModuloType = 0
                dmaLogicChannelConfig_SourceSignedOffsetType = 0
                dmaTransferConfig_TransferSizeType = DMA_IP_TRANSFER_SIZE_1_BYTE
        dmaLogicChannel_Spi2_Rx: index=3, dmaLogicChannel_HwChId=DMA_IP_HW_CH_4, dmaLogicChannel_LogicName=DMA_LOGIC_CH_4
          dmaLogicChannel_ConfigType
            dmaLogicChannel_GlobalConfigType
              dmaLogicChannelConfig_GlobalInterruptType: dmaGlobalInterrupt_enDmaErrorInterrupt=0
              dmaLogicChannelConfig_GlobalPriorityType: dmaGlobalPriority_LevelPriority=DMA_IP_LEVEL_PRIO3, dmaGlobalPriority_disPreempt=0, dmaGlobalPriority_enPreemption=0
              dmaLogicChannelConfig_GlobalRequestType:
                dmaGlobalRequest_Dmamux0HwRequest = DMA_IP_REQ_MUX0_DISABLED
                dmaGlobalRequest_enDmaRequest = 0
                dmaGlobalRequest_enDmamuxSource = 0
                dmaGlobalRequest_enDmamuxTrigger = 0
            dmaLogicChannel_ScatterGatherConfigType
            dmaLogicChannel_TransferConfigType
              dmaLogicChannelConfig_TransferControlType:
                dmaLogicChannelConfig_DestinationStoreAddressType = 0U
                dmaLogicChannelConfig_ScatterGatherAddressType = 0U
                dmaLogicChannelConfig_bandwidthControl = DMA_IP_BWC_ENGINE_NO_STALL
                dmaLogicChannelConfig_disDmaAutoHwReq = 0
                dmaLogicChannelConfig_enDmaHalfMajorInterrupt = 0
                dmaLogicChannelConfig_enDmaMajorInterrupt = 0
                dmaLogicChannelConfig_enStart = 0
              dmaLogicChannelConfig_TransferDestinationType:
                dmaLogicChannelConfig_DestinationAddressType = 0
                dmaLogicChannelConfig_DestinationLastAddressAdjustmentType = 0
                dmaLogicChannelConfig_DestinationModuloType = 0
                dmaLogicChannelConfig_DestinationSignedOffsetType = 0
                dmaTransferConfig_TransferSizeType = DMA_IP_TRANSFER_SIZE_1_BYTE
              dmaLogicChannelConfig_TransferMajorLoopType: dmaLogicChannelConfig_MajorLoopCountType=1, dmaLogicChannelConfig_enMajorLoopLinkCh=0
              dmaLogicChannelConfig_TransferMinorLoopType:
                dmaLogicChannelConfig_MinorLoopSizeType = 0
                dmaLogicChannelConfig_OffsetValueType = 0
                dmaLogicChannelConfig_enDestinationOffset = 0
                dmaLogicChannelConfig_enMinorLoopLinkCh = 0
                dmaLogicChannelConfig_enSourceOffset = 0
              dmaLogicChannelConfig_TransferSourceType:
                dmaLogicChannelConfig_SourceAddressType = 0
                dmaLogicChannelConfig_SourceLastAddressAdjustmentType = 0
                dmaLogicChannelConfig_SourceModuloType = 0
                dmaLogicChannelConfig_SourceSignedOffsetType = 0
                dmaTransferConfig_TransferSizeType = DMA_IP_TRANSFER_SIZE_1_BYTE
        dmaLogicChannel_Uart0_Tx: index=4, dmaLogicChannel_HwChId=DMA_IP_HW_CH_6, dmaLogicChannel_LogicName=DMA_LOGIC_CH_6
          dmaLogicChannel_ConfigType
            dmaLogicChannel_GlobalConfigType
              dmaLogicChannelConfig_GlobalInterruptType: dmaGlobalInterrupt_enDmaErrorInterrupt=0
              dmaLogicChannelConfig_GlobalPriorityType: dmaGlobalPriority_LevelPriority=DMA_IP_LEVEL_PRIO4, dmaGlobalPriority_disPreempt=0, dmaGlobalPriority_enPreemption=0
              dmaLogicChannelConfig_GlobalRequestType:
                dmaGlobalRequest_Dmamux0HwRequest = DMA_IP_REQ_MUX0_DISABLED
                dmaGlobalRequest_enDmaRequest = 1
                dmaGlobalRequest_enDmamuxSource = 0
                dmaGlobalRequest_enDmamuxTrigger = 0
            dmaLogicChannel_ScatterGatherConfigType
            dmaLogicChannel_TransferConfigType
              dmaLogicChannelConfig_TransferControlType:
                dmaLogicChannelConfig_DestinationStoreAddressType = 0U
                dmaLogicChannelConfig_ScatterGatherAddressType = 0U
                dmaLogicChannelConfig_bandwidthControl = DMA_IP_BWC_ENGINE_NO_STALL
                dmaLogicChannelConfig_disDmaAutoHwReq = 0
                dmaLogicChannelConfig_enDmaHalfMajorInterrupt = 0
                dmaLogicChannelConfig_enDmaMajorInterrupt = 0
                dmaLogicChannelConfig_enStart = 0
              dmaLogicChannelConfig_TransferDestinationType:
                dmaLogicChannelConfig_DestinationAddressType = 0
                dmaLogicChannelConfig_DestinationLastAddressAdjustmentType = 0
                dmaLogicChannelConfig_DestinationModuloType = 0
                dmaLogicChannelConfig_DestinationSignedOffsetType = 0
                dmaTransferConfig_TransferSizeType = DMA_IP_TRANSFER_SIZE_1_BYTE
              dmaLogicChannelConfig_TransferMajorLoopType: dmaLogicChannelConfig_MajorLoopCountType=1, dmaLogicChannelConfig_enMajorLoopLinkCh=0
              dmaLogicChannelConfig_TransferMinorLoopType:
                dmaLogicChannelConfig_MinorLoopSizeType = 0
                dmaLogicChannelConfig_OffsetValueType = 0
                dmaLogicChannelConfig_enDestinationOffset = 0
                dmaLogicChannelConfig_enMinorLoopLinkCh = 0
                dmaLogicChannelConfig_enSourceOffset = 0
              dmaLogicChannelConfig_TransferSourceType:
                dmaLogicChannelConfig_SourceAddressType = 0
                dmaLogicChannelConfig_SourceLastAddressAdjustmentType = 0
                dmaLogicChannelConfig_SourceModuloType = 0
                dmaLogicChannelConfig_SourceSignedOffsetType = 0
                dmaTransferConfig_TransferSizeType = DMA_IP_TRANSFER_SIZE_1_BYTE
        dmaLogicChannel_Uart0_Rx: index=5, dmaLogicChannel_HwChId=DMA_IP_HW_CH_7, dmaLogicChannel_LogicName=DMA_LOGIC_CH_7
          dmaLogicChannel_ConfigType
            dmaLogicChannel_GlobalConfigType
              dmaLogicChannelConfig_GlobalInterruptType: dmaGlobalInterrupt_enDmaErrorInterrupt=0
              dmaLogicChannelConfig_GlobalPriorityType: dmaGlobalPriority_LevelPriority=DMA_IP_LEVEL_PRIO5, dmaGlobalPriority_disPreempt=0, dmaGlobalPriority_enPreemption=0
              dmaLogicChannelConfig_GlobalRequestType:
                dmaGlobalRequest_Dmamux0HwRequest = DMA_IP_REQ_MUX0_DISABLED
                dmaGlobalRequest_enDmaRequest = 1
                dmaGlobalRequest_enDmamuxSource = 0
                dmaGlobalRequest_enDmamuxTrigger = 0
            dmaLogicChannel_ScatterGatherConfigType
            dmaLogicChannel_TransferConfigType
              dmaLogicChannelConfig_TransferControlType:
                dmaLogicChannelConfig_DestinationStoreAddressType = 0U
                dmaLogicChannelConfig_ScatterGatherAddressType = 0U
                dmaLogicChannelConfig_bandwidthControl = DMA_IP_BWC_ENGINE_NO_STALL
                dmaLogicChannelConfig_disDmaAutoHwReq = 0
                dmaLogicChannelConfig_enDmaHalfMajorInterrupt = 0
                dmaLogicChannelConfig_enDmaMajorInterrupt = 0
                dmaLogicChannelConfig_enStart = 0
              dmaLogicChannelConfig_TransferDestinationType:
                dmaLogicChannelConfig_DestinationAddressType = 0
                dmaLogicChannelConfig_DestinationLastAddressAdjustmentType = 0
                dmaLogicChannelConfig_DestinationModuloType = 0
                dmaLogicChannelConfig_DestinationSignedOffsetType = 0
                dmaTransferConfig_TransferSizeType = DMA_IP_TRANSFER_SIZE_1_BYTE
              dmaLogicChannelConfig_TransferMajorLoopType: dmaLogicChannelConfig_MajorLoopCountType=1, dmaLogicChannelConfig_enMajorLoopLinkCh=0
              dmaLogicChannelConfig_TransferMinorLoopType:
                dmaLogicChannelConfig_MinorLoopSizeType = 0
                dmaLogicChannelConfig_OffsetValueType = 0
                dmaLogicChannelConfig_enDestinationOffset = 0
                dmaLogicChannelConfig_enMinorLoopLinkCh = 0
                dmaLogicChannelConfig_enSourceOffset = 0
              dmaLogicChannelConfig_TransferSourceType:
                dmaLogicChannelConfig_SourceAddressType = 0
                dmaLogicChannelConfig_SourceLastAddressAdjustmentType = 0
                dmaLogicChannelConfig_SourceModuloType = 0
                dmaLogicChannelConfig_SourceSignedOffsetType = 0
                dmaTransferConfig_TransferSizeType = DMA_IP_TRANSFER_SIZE_1_BYTE
        dmaLogicChannel_Uart1_Tx: index=6, dmaLogicChannel_HwChId=DMA_IP_HW_CH_1, dmaLogicChannel_LogicName=DMA_LOGIC_CH_1
          dmaLogicChannel_ConfigType
            dmaLogicChannel_GlobalConfigType
              dmaLogicChannelConfig_GlobalInterruptType: dmaGlobalInterrupt_enDmaErrorInterrupt=0
              dmaLogicChannelConfig_GlobalPriorityType: dmaGlobalPriority_LevelPriority=DMA_IP_LEVEL_PRIO6, dmaGlobalPriority_disPreempt=0, dmaGlobalPriority_enPreemption=0
              dmaLogicChannelConfig_GlobalRequestType:
                dmaGlobalRequest_Dmamux0HwRequest = DMA_IP_REQ_MUX0_DISABLED
                dmaGlobalRequest_enDmaRequest = 1
                dmaGlobalRequest_enDmamuxSource = 0
                dmaGlobalRequest_enDmamuxTrigger = 0
            dmaLogicChannel_ScatterGatherConfigType
            dmaLogicChannel_TransferConfigType
              dmaLogicChannelConfig_TransferControlType:
                dmaLogicChannelConfig_DestinationStoreAddressType = 0U
                dmaLogicChannelConfig_ScatterGatherAddressType = 0U
                dmaLogicChannelConfig_bandwidthControl = DMA_IP_BWC_ENGINE_NO_STALL
                dmaLogicChannelConfig_disDmaAutoHwReq = 0
                dmaLogicChannelConfig_enDmaHalfMajorInterrupt = 0
                dmaLogicChannelConfig_enDmaMajorInterrupt = 0
                dmaLogicChannelConfig_enStart = 0
              dmaLogicChannelConfig_TransferDestinationType:
                dmaLogicChannelConfig_DestinationAddressType = 0
                dmaLogicChannelConfig_DestinationLastAddressAdjustmentType = 0
                dmaLogicChannelConfig_DestinationModuloType = 0
                dmaLogicChannelConfig_DestinationSignedOffsetType = 0
                dmaTransferConfig_TransferSizeType = DMA_IP_TRANSFER_SIZE_1_BYTE
              dmaLogicChannelConfig_TransferMajorLoopType: dmaLogicChannelConfig_MajorLoopCountType=1, dmaLogicChannelConfig_enMajorLoopLinkCh=0
              dmaLogicChannelConfig_TransferMinorLoopType:
                dmaLogicChannelConfig_MinorLoopSizeType = 0
                dmaLogicChannelConfig_OffsetValueType = 0
                dmaLogicChannelConfig_enDestinationOffset = 0
                dmaLogicChannelConfig_enMinorLoopLinkCh = 0
                dmaLogicChannelConfig_enSourceOffset = 0
              dmaLogicChannelConfig_TransferSourceType:
                dmaLogicChannelConfig_SourceAddressType = 0
                dmaLogicChannelConfig_SourceLastAddressAdjustmentType = 0
                dmaLogicChannelConfig_SourceModuloType = 0
                dmaLogicChannelConfig_SourceSignedOffsetType = 0
                dmaTransferConfig_TransferSizeType = DMA_IP_TRANSFER_SIZE_1_BYTE
        dmaLogicChannel_Uart1_Rx: index=7, dmaLogicChannel_HwChId=DMA_IP_HW_CH_0, dmaLogicChannel_LogicName=DMA_LOGIC_CH_0
          dmaLogicChannel_ConfigType
            dmaLogicChannel_GlobalConfigType
              dmaLogicChannelConfig_GlobalInterruptType: dmaGlobalInterrupt_enDmaErrorInterrupt=0
              dmaLogicChannelConfig_GlobalPriorityType: dmaGlobalPriority_LevelPriority=DMA_IP_LEVEL_PRIO7, dmaGlobalPriority_disPreempt=0, dmaGlobalPriority_enPreemption=0
              dmaLogicChannelConfig_GlobalRequestType:
                dmaGlobalRequest_Dmamux0HwRequest = DMA_IP_REQ_MUX0_DISABLED
                dmaGlobalRequest_enDmaRequest = 1
                dmaGlobalRequest_enDmamuxSource = 0
                dmaGlobalRequest_enDmamuxTrigger = 0
            dmaLogicChannel_ScatterGatherConfigType
            dmaLogicChannel_TransferConfigType
              dmaLogicChannelConfig_TransferControlType:
                dmaLogicChannelConfig_DestinationStoreAddressType = 0U
                dmaLogicChannelConfig_ScatterGatherAddressType = 0U
                dmaLogicChannelConfig_bandwidthControl = DMA_IP_BWC_ENGINE_NO_STALL
                dmaLogicChannelConfig_disDmaAutoHwReq = 0
                dmaLogicChannelConfig_enDmaHalfMajorInterrupt = 0
                dmaLogicChannelConfig_enDmaMajorInterrupt = 0
                dmaLogicChannelConfig_enStart = 0
              dmaLogicChannelConfig_TransferDestinationType:
                dmaLogicChannelConfig_DestinationAddressType = 0
                dmaLogicChannelConfig_DestinationLastAddressAdjustmentType = 0
                dmaLogicChannelConfig_DestinationModuloType = 0
                dmaLogicChannelConfig_DestinationSignedOffsetType = 0
                dmaTransferConfig_TransferSizeType = DMA_IP_TRANSFER_SIZE_1_BYTE
              dmaLogicChannelConfig_TransferMajorLoopType: dmaLogicChannelConfig_MajorLoopCountType=1, dmaLogicChannelConfig_enMajorLoopLinkCh=0
              dmaLogicChannelConfig_TransferMinorLoopType:
                dmaLogicChannelConfig_MinorLoopSizeType = 0
                dmaLogicChannelConfig_OffsetValueType = 0
                dmaLogicChannelConfig_enDestinationOffset = 0
                dmaLogicChannelConfig_enMinorLoopLinkCh = 0
                dmaLogicChannelConfig_enSourceOffset = 0
              dmaLogicChannelConfig_TransferSourceType:
                dmaLogicChannelConfig_SourceAddressType = 0
                dmaLogicChannelConfig_SourceLastAddressAdjustmentType = 0
                dmaLogicChannelConfig_SourceModuloType = 0
                dmaLogicChannelConfig_SourceSignedOffsetType = 0
                dmaTransferConfig_TransferSizeType = DMA_IP_TRANSFER_SIZE_1_BYTE
      dmaLogicInstance_ConfigType_0 (dmaLogicInstance_ConfigType):
        index = 0
        dmaLogicInstance_IdName = DMA_LOGIC_INST_0
        dmaLogicInstance_enChLinking = 0
        dmaLogicInstance_enDebug = 0
        dmaLogicInstance_enHaltAfterError = 0
        dmaLogicInstance_enRoundRobin = 0
        dmaLogicInstance_hwId = DMA_IP_HW_INST_0
    MclGeneral:
      MclEnableDemReportErrorStatus = 0
      MclEnableDevErrorDetect = 0
      MclEnableUserModeSupport = 0
      MclEnableVirtualAddressMappingSupport = 0
      Mcl_VersionInfoApi = 1
      MclCache: MclCacheTimeoutMethod=OSIF_COUNTER_DUMMY, MclCacheTimeoutValue=0, MclEnableCache=0
      MclDma: MclEnableDma=1
      MclFlexioCommon: MclEnableFlexioCommon=0
      MclFtmCommon: Mcl_FtmCommonTimebase=0
      MclTrgMux: MclEnableTrgMux=0
package /Port
  module config Port: implementation-config-variant=VARIANT-POST-BUILD
    CommonPublishedInformation:
      ArReleaseMajorVersion = 4
      ArReleaseMinorVersion = 4
      ArReleaseRevisionVersion = 0
      ModuleId = 124
      SwMajorVersion = 1
      SwMinorVersion = 0
      SwPatchVersion = 1
      VendorId = 43
    PortConfigSet
      NotUsedPortPin:
        PortPinDSE = Low_Drive_Strength
        PortPinDirection = PORT_PIN_IN
        PortPinLevelValue = PORT_PIN_LEVEL_LOW
        PortPinMode = GPIO
        PortPinPE = PullDisabled
        PortPinPS = PullDown
      5 x PortContainer:
        PortA: PortNumberOfPortPins=20
          20 x PortPin, all with PortPinDSE=Low_Drive_Strength, PortPinDirectionChangeable=1, PortPinInitialMode=PORT_GPIO_MODE, PortPinLK=0, PortPinModeChangeable=1, PortPinPFE=0:
            PortPin_BRAKE_OIL_LEVEL_ALARM_IN: PortPinDirection=PORT_PIN_IN, PortPinId=12, PortPinLevelValue=PORT_PIN_LEVEL_LOW, PortPinMode=GPIO, PortPinPE=PullDisabled, PortPinPS=PullDown, PortPinPcr=17
            PortPin_BREAK_SHOE_ALARM1_IN: PortPinDirection=PORT_PIN_IN, PortPinId=10, PortPinLevelValue=PORT_PIN_LEVEL_LOW, PortPinMode=GPIO, PortPinPE=PullDisabled, PortPinPS=PullDown, PortPinPcr=15
            PortPin_BREAK_SHOE_ALARM2_IN: PortPinDirection=PORT_PIN_IN, PortPinId=11, PortPinLevelValue=PORT_PIN_LEVEL_LOW, PortPinMode=GPIO, PortPinPE=PullDisabled, PortPinPS=PullDown, PortPinPcr=16
            PortPin_BSTON: PortPinDirection=PORT_PIN_IN, PortPinId=20, PortPinLevelValue=PORT_PIN_LEVEL_LOW, PortPinMode=GPIO, PortPinPE=PullDisabled, PortPinPS=PullDown, PortPinPcr=25
            PortPin_DISPLAY_MCU_I2C_SCL: PortPinDirection=PORT_PIN_OUT, PortPinId=1, PortPinLevelValue=PORT_PIN_LEVEL_HIGH, PortPinMode=LPI2C0_SCLS, PortPinPE=PullEnabled, PortPinPS=PullUp, PortPinPcr=0
            PortPin_DISPLAY_MCU_I2C_SDA: PortPinDirection=PORT_PIN_OUT, PortPinId=2, PortPinLevelValue=PORT_PIN_LEVEL_HIGH, PortPinMode=LPI2C0_SDAS, PortPinPE=PullEnabled, PortPinPS=PullUp, PortPinPcr=1
            PortPin_DSI0_1V0_PGOOD: PortPinDirection=PORT_PIN_IN, PortPinId=19, PortPinLevelValue=PORT_PIN_LEVEL_LOW, PortPinMode=GPIO, PortPinPE=PullDisabled, PortPinPS=PullDown, PortPinPcr=24
            PortPin_EXT_3V3_PGOOD: PortPinDirection=PORT_PIN_IN, PortPinId=17, PortPinLevelValue=PORT_PIN_LEVEL_LOW, PortPinMode=GPIO, PortPinPE=PullDisabled, PortPinPS=PullDown, PortPinPcr=22
            PortPin_FAN_PGOOD: PortPinDirection=PORT_PIN_IN, PortPinId=15, PortPinLevelValue=PORT_PIN_LEVEL_LOW, PortPinMode=GPIO, PortPinPE=PullDisabled, PortPinPS=PullDown, PortPinPcr=20
            PortPin_MCU_POWER_ON_LED: PortPinDirection=PORT_PIN_OUT, PortPinId=9, PortPinLevelValue=PORT_PIN_LEVEL_LOW, PortPinMode=GPIO, PortPinPE=PullDisabled, PortPinPS=PullDown, PortPinPcr=14
            PortPin_MCU_SOC_FAULT_IN: PortPinDirection=PORT_PIN_IN, PortPinId=8, PortPinLevelValue=PORT_PIN_LEVEL_LOW, PortPinMode=GPIO, PortPinPE=PullDisabled, PortPinPS=PullDown, PortPinPcr=9
            PortPin_MCU_SOC_UART0_RX: PortPinDirection=PORT_PIN_IN, PortPinId=3, PortPinLevelValue=PORT_PIN_LEVEL_HIGH, PortPinMode=LPUART0_RX, PortPinPE=PullEnabled, PortPinPS=PullUp, PortPinPcr=2
            PortPin_MCU_SOC_UART0_TX: PortPinDirection=PORT_PIN_OUT, PortPinId=4, PortPinLevelValue=PORT_PIN_LEVEL_HIGH, PortPinMode=LPUART0_TX, PortPinPE=PullEnabled, PortPinPS=PullUp, PortPinPcr=3
            PortPin_OVER_VOL_FLAG: PortPinDirection=PORT_PIN_IN, PortPinId=14, PortPinLevelValue=PORT_PIN_LEVEL_LOW, PortPinMode=GPIO, PortPinPE=PullDisabled, PortPinPS=PullDown, PortPinPcr=19
            PortPin_PA_PGOOD: PortPinDirection=PORT_PIN_IN, PortPinId=18, PortPinLevelValue=PORT_PIN_LEVEL_LOW, PortPinMode=GPIO, PortPinPE=PullDisabled, PortPinPS=PullDown, PortPinPcr=23
            PortPin_SPI_MCU_SOC_MISO: PortPinDirection=PORT_PIN_IN, PortPinId=7, PortPinLevelValue=PORT_PIN_LEVEL_LOW, PortPinMode=LPSPI2_SOUT, PortPinPE=PullDisabled, PortPinPS=PullDown, PortPinPcr=8
            PortPin_SYS_3V3_PGOOD: PortPinDirection=PORT_PIN_IN, PortPinId=16, PortPinLevelValue=PORT_PIN_LEVEL_LOW, PortPinMode=GPIO, PortPinPE=PullDisabled, PortPinPS=PullDown, PortPinPcr=21
            PortPin_TANK_MCU_1_DETECT_IN: PortPinDirection=PORT_PIN_IN, PortPinId=6, PortPinLevelValue=PORT_PIN_LEVEL_LOW, PortPinMode=ADC0_SE3, PortPinPE=PullDisabled, PortPinPS=PullDown, PortPinPcr=7
            PortPin_TANK_MCU_2_DETECT_IN: PortPinDirection=PORT_PIN_IN, PortPinId=5, PortPinLevelValue=PORT_PIN_LEVEL_LOW, PortPinMode=ADC0_SE2, PortPinPE=PullDisabled, PortPinPS=PullDown, PortPinPcr=6
            PortPin_UNDER_VOL_FLAG: PortPinDirection=PORT_PIN_IN, PortPinId=13, PortPinLevelValue=PORT_PIN_LEVEL_LOW, PortPinMode=GPIO, PortPinPE=PullDisabled, PortPinPS=PullDown, PortPinPcr=18
        PortB: PortNumberOfPortPins=20
          20 x PortPin, all with PortPinDSE=Low_Drive_Strength, PortPinDirectionChangeable=1, PortPinInitialMode=PORT_GPIO_MODE, PortPinLK=0, PortPinLevelValue=PORT_PIN_LEVEL_LOW, PortPinModeChangeable=1, PortPinPE=PullDisabled, PortPinPFE=0, PortPinPS=PullDown:
            PortPin_ALL_OP_SHDN: PortPinDirection=PORT_PIN_OUT, PortPinId=27, PortPinMode=GPIO, PortPinPcr=45
            PortPin_DISP_CENTER_INT: PortPinDirection=PORT_PIN_IN, PortPinId=37, PortPinMode=GPIO, PortPinPcr=56
            PortPin_DISP_CLUSTER_INT: PortPinDirection=PORT_PIN_IN, PortPinId=38, PortPinMode=GPIO, PortPinPcr=58
            PortPin_DISP_PASSENGER_INT: PortPinDirection=PORT_PIN_IN, PortPinId=32, PortPinMode=GPIO, PortPinPcr=51
            PortPin_DISP_RIGHT_INT: PortPinDirection=PORT_PIN_IN, PortPinId=39, PortPinMode=GPIO, PortPinPcr=62
            PortPin_ETH_WAKE_UP_DETECT: PortPinDirection=PORT_PIN_IN, PortPinId=40, PortPinMode=GPIO, PortPinPcr=63
            PortPin_FAN_PWR_IN: PortPinDirection=PORT_PIN_OUT, PortPinId=26, PortPinMode=GPIO, PortPinPcr=44
            PortPin_FIR_AVDD12_EXT_PGOOD: PortPinDirection=PORT_PIN_IN, PortPinId=36, PortPinMode=GPIO, PortPinPcr=55
            PortPin_I2S_PA_BLCK: PortPinDirection=PORT_PIN_OUT, PortPinId=22, PortPinMode=SAI1_BCLK, PortPinPcr=40
            PortPin_I2S_PA_DATA: PortPinDirection=PORT_PIN_OUT, PortPinId=23, PortPinMode=SAI1_D0, PortPinPcr=41
            PortPin_I2S_PA_MCLK: PortPinDirection=PORT_PIN_OUT, PortPinId=24, PortPinMode=SAI1_MCLK, PortPinPcr=42
            PortPin_IGN_INPUT_DETECT: PortPinDirection=PORT_PIN_IN, PortPinId=25, PortPinMode=GPIO, PortPinPcr=43
            PortPin_MCU_MII_MDIO: PortPinDirection=PORT_PIN_HIGH_Z, PortPinId=21, PortPinMode=MII_RMII_MDIO, PortPinPcr=36
            PortPin_PHY_0V9_PGOOD: PortPinDirection=PORT_PIN_IN, PortPinId=35, PortPinMode=GPIO, PortPinPcr=54
            PortPin_SBC_CS: PortPinDirection=PORT_PIN_OUT, PortPinId=31, PortPinMode=LPSPI1_PCS3, PortPinPcr=49
            PortPin_SBC_MISO: PortPinDirection=PORT_PIN_IN, PortPinId=29, PortPinMode=LPSPI1_SIN, PortPinPcr=47
            PortPin_SBC_MOSI: PortPinDirection=PORT_PIN_OUT, PortPinId=30, PortPinMode=LPSPI1_SOUT, PortPinPcr=48
            PortPin_SBC_SCLK: PortPinDirection=PORT_PIN_OUT, PortPinId=28, PortPinMode=LPSPI1_SCK, PortPinPcr=46
            PortPin_VBAT_ALL_MUX: PortPinDirection=PORT_PIN_IN, PortPinId=33, PortPinMode=ADC0_SE17, PortPinPcr=52
            PortPin_VBAT_MB_MUX: PortPinDirection=PORT_PIN_IN, PortPinId=34, PortPinMode=ADC0_SE18, PortPinPcr=53
        PortC: PortNumberOfPortPins=24
          24 x PortPin, all with PortPinDSE=Low_Drive_Strength, PortPinDirectionChangeable=1, PortPinInitialMode=PORT_GPIO_MODE, PortPinLK=0, PortPinModeChangeable=1, PortPinPFE=0:
            PortPin_ACC_SENSOR_FSYNC: PortPinDirection=PORT_PIN_OUT, PortPinId=60, PortPinLevelValue=PORT_PIN_LEVEL_LOW, PortPinMode=GPIO, PortPinPE=PullDisabled, PortPinPS=PullDown, PortPinPcr=91
            PortPin_ACC_SENSOR_INT1: PortPinDirection=PORT_PIN_IN, PortPinId=61, PortPinLevelValue=PORT_PIN_LEVEL_LOW, PortPinMode=GPIO, PortPinPE=PullDisabled, PortPinPS=PullDown, PortPinPcr=92
            PortPin_ACC_SENSOR_INT2: PortPinDirection=PORT_PIN_IN, PortPinId=62, PortPinLevelValue=PORT_PIN_LEVEL_LOW, PortPinMode=GPIO, PortPinPE=PullDisabled, PortPinPS=PullDown, PortPinPcr=93
            PortPin_EXT1_1V8_PGOOD: PortPinDirection=PORT_PIN_IN, PortPinId=53, PortPinLevelValue=PORT_PIN_LEVEL_LOW, PortPinMode=GPIO, PortPinPE=PullDisabled, PortPinPS=PullDown, PortPinPcr=82
            PortPin_EXT2_1V8_PGOOD: PortPinDirection=PORT_PIN_IN, PortPinId=55, PortPinLevelValue=PORT_PIN_LEVEL_LOW, PortPinMode=GPIO, PortPinPE=PullDisabled, PortPinPS=PullDown, PortPinPcr=85
            PortPin_KBD_PWM_1: PortPinDirection=PORT_PIN_OUT, PortPinId=63, PortPinLevelValue=PORT_PIN_LEVEL_LOW, PortPinMode=FTM5_CH4, PortPinPE=PullDisabled, PortPinPS=PullDown, PortPinPcr=94
            PortPin_KBD_PWM_1_EN: PortPinDirection=PORT_PIN_OUT, PortPinId=56, PortPinLevelValue=PORT_PIN_LEVEL_LOW, PortPinMode=GPIO, PortPinPE=PullDisabled, PortPinPS=PullDown, PortPinPcr=86
            PortPin_KBD_PWM_1_FAULT: PortPinDirection=PORT_PIN_IN, PortPinId=57, PortPinLevelValue=PORT_PIN_LEVEL_LOW, PortPinMode=GPIO, PortPinPE=PullDisabled, PortPinPS=PullDown, PortPinPcr=88
            PortPin_KBD_PWM_2: PortPinDirection=PORT_PIN_OUT, PortPinId=64, PortPinLevelValue=PORT_PIN_LEVEL_LOW, PortPinMode=FTM5_CH6, PortPinPE=PullDisabled, PortPinPS=PullDown, PortPinPcr=95
            PortPin_KBD_PWM_2_EN: PortPinDirection=PORT_PIN_OUT, PortPinId=58, PortPinLevelValue=PORT_PIN_LEVEL_LOW, PortPinMode=GPIO, PortPinPE=PullDisabled, PortPinPS=PullDown, PortPinPcr=89
            PortPin_KBD_PWM_2_FAULT: PortPinDirection=PORT_PIN_IN, PortPinId=59, PortPinLevelValue=PORT_PIN_LEVEL_LOW, PortPinMode=GPIO, PortPinPE=PullDisabled, PortPinPS=PullDown, PortPinPcr=90
            PortPin_MCU_MAX20030_EN1: PortPinDirection=PORT_PIN_OUT, PortPinId=48, PortPinLevelValue=PORT_PIN_LEVEL_LOW, PortPinMode=GPIO, PortPinPE=PullDisabled, PortPinPS=PullDown, PortPinPcr=74
            PortPin_MCU_MAX20030_EN2: PortPinDirection=PORT_PIN_OUT, PortPinId=49, PortPinLevelValue=PORT_PIN_LEVEL_LOW, PortPinMode=GPIO, PortPinPE=PullDisabled, PortPinPS=PullDown, PortPinPcr=75
            PortPin_MCU_MAX20030_EN3: PortPinDirection=PORT_PIN_OUT, PortPinId=50, PortPinLevelValue=PORT_PIN_LEVEL_LOW, PortPinMode=GPIO, PortPinPE=PullDisabled, PortPinPS=PullDown, PortPinPcr=76
            PortPin_MCU_MAX20030_EN4: PortPinDirection=PORT_PIN_OUT, PortPinId=51, PortPinLevelValue=PORT_PIN_LEVEL_LOW, PortPinMode=GPIO, PortPinPE=PullDisabled, PortPinPS=PullDown, PortPinPcr=77
            PortPin_MCU_MII_RXD0: PortPinDirection=PORT_PIN_HIGH_Z, PortPinId=42, PortPinLevelValue=PORT_PIN_LEVEL_LOW, PortPinMode=MII_RMII_RXD_0, PortPinPE=PullDisabled, PortPinPS=PullDown, PortPinPcr=65
            PortPin_MCU_MII_RXD1: PortPinDirection=PORT_PIN_HIGH_Z, PortPinId=41, PortPinLevelValue=PORT_PIN_LEVEL_LOW, PortPinMode=MII_RMII_RXD_1, PortPinPE=PullDisabled, PortPinPS=PullDown, PortPinPcr=64
            PortPin_MCU_MII_RX_EN: PortPinDirection=PORT_PIN_HIGH_Z, PortPinId=52, PortPinLevelValue=PORT_PIN_LEVEL_LOW, PortPinMode=MII_RMII_RX_DV, PortPinPE=PullDisabled, PortPinPS=PullDown, PortPinPcr=81
            PortPin_MCU_MII_TXD0: PortPinDirection=PORT_PIN_HIGH_Z, PortPinId=43, PortPinLevelValue=PORT_PIN_LEVEL_LOW, PortPinMode=MII_RMII_TXD_0, PortPinPE=PullDisabled, PortPinPS=PullDown, PortPinPcr=66
            PortPin_MCU_UART1_RX: PortPinDirection=PORT_PIN_IN, PortPinId=46, PortPinLevelValue=PORT_PIN_LEVEL_LOW, PortPinMode=LPUART1_RX, PortPinPE=PullDisabled, PortPinPS=PullDown, PortPinPcr=72
            PortPin_MCU_UART1_TX: PortPinDirection=PORT_PIN_OUT, PortPinId=47, PortPinLevelValue=PORT_PIN_LEVEL_LOW, PortPinMode=LPUART1_TX, PortPinPE=PullDisabled, PortPinPS=PullDown, PortPinPcr=73
            PortPin_SBC_CAN_RX: PortPinDirection=PORT_PIN_IN, PortPinId=44, PortPinLevelValue=PORT_PIN_LEVEL_HIGH, PortPinMode=CAN1_RX, PortPinPE=PullEnabled, PortPinPS=PullUp, PortPinPcr=70
            PortPin_SBC_CAN_TX: PortPinDirection=PORT_PIN_OUT, PortPinId=45, PortPinLevelValue=PORT_PIN_LEVEL_HIGH, PortPinMode=CAN1_TX, PortPinPE=PullEnabled, PortPinPS=PullUp, PortPinPcr=71
            PortPin_SYS_1V8_PGOOD: PortPinDirection=PORT_PIN_IN, PortPinId=54, PortPinLevelValue=PORT_PIN_LEVEL_LOW, PortPinMode=GPIO, PortPinPE=PullDisabled, PortPinPS=PullDown, PortPinPcr=84
        PortD: PortNumberOfPortPins=27
          27 x PortPin, all with PortPinDSE=Low_Drive_Strength, PortPinDirectionChangeable=1, PortPinInitialMode=PORT_GPIO_MODE, PortPinLK=0, PortPinLevelValue=PORT_PIN_LEVEL_LOW, PortPinModeChangeable=1, PortPinPE=PullDisabled, PortPinPFE=0, PortPinPS=PullDown:
            PortPin_A2B_PGOOD: PortPinDirection=PORT_PIN_IN, PortPinId=86, PortPinMode=GPIO, PortPinPcr=122
            PortPin_AUDIO_PA_FAULT: PortPinDirection=PORT_PIN_IN, PortPinId=80, PortPinMode=GPIO, PortPinPcr=116
            PortPin_CSI0_1V2_PGOOD: PortPinDirection=PORT_PIN_IN, PortPinId=88, PortPinMode=GPIO, PortPinPcr=124
            PortPin_CSI1_1V2_PGOOD: PortPinDirection=PORT_PIN_IN, PortPinId=87, PortPinMode=GPIO, PortPinPcr=123
            PortPin_CSI2_1V2_PGOOD: PortPinDirection=PORT_PIN_IN, PortPinId=89, PortPinMode=GPIO, PortPinPcr=125
            PortPin_CSI3_1V2_PGOOD: PortPinDirection=PORT_PIN_IN, PortPinId=90, PortPinMode=GPIO, PortPinPcr=126
            PortPin_DISP_LEFT_INT: PortPinDirection=PORT_PIN_IN, PortPinId=85, PortPinMode=GPIO, PortPinPcr=121
            PortPin_HW_PHASE_ID: PortPinDirection=PORT_PIN_IN, PortPinId=82, PortPinMode=ADC1_SE18, PortPinPcr=118
            PortPin_HW_PHASE_VERSION_ID: PortPinDirection=PORT_PIN_IN, PortPinId=83, PortPinMode=ADC1_SE19, PortPinPcr=119
            PortPin_MCU_CTRL_SOC_DL: PortPinDirection=PORT_PIN_OUT, PortPinId=65, PortPinMode=GPIO, PortPinPcr=96
            PortPin_MCU_MB_SENSOR_INT: PortPinDirection=PORT_PIN_IN, PortPinId=66, PortPinMode=GPIO, PortPinPcr=97
            PortPin_MCU_MII_RXD2: PortPinDirection=PORT_PIN_HIGH_Z, PortPinId=73, PortPinMode=MII_RXD2, PortPinPcr=105
            PortPin_MCU_MII_RXD3: PortPinDirection=PORT_PIN_HIGH_Z, PortPinId=72, PortPinMode=MII_RXD3, PortPinPcr=104
            PortPin_MCU_MII_RX_CLK: PortPinDirection=PORT_PIN_HIGH_Z, PortPinId=74, PortPinMode=MII_RX_CLK, PortPinPcr=106
            PortPin_MCU_MII_TXD1: PortPinDirection=PORT_PIN_HIGH_Z, PortPinId=71, PortPinMode=MII_RMII_TXD_1, PortPinPcr=103
            PortPin_MCU_MII_TXD2: PortPinDirection=PORT_PIN_HIGH_Z, PortPinId=70, PortPinMode=MII_TXD2, PortPinPcr=102
            PortPin_MCU_MII_TXD3: PortPinDirection=PORT_PIN_HIGH_Z, PortPinId=69, PortPinMode=MII_TXD3, PortPinPcr=101
            PortPin_MCU_MII_TX_CLK: PortPinDirection=PORT_PIN_HIGH_Z, PortPinId=75, PortPinMode=MII_RMII_TX_CLK, PortPinPcr=107
            PortPin_MCU_MII_TX_EN: PortPinDirection=PORT_PIN_HIGH_Z, PortPinId=76, PortPinMode=GPIO, PortPinPcr=108
            PortPin_MCU_RESET_SOC_IN: PortPinDirection=PORT_PIN_OUT, PortPinId=77, PortPinMode=GPIO, PortPinPcr=109
            PortPin_MCU_REST_PA: PortPinDirection=PORT_PIN_OUT, PortPinId=81, PortPinMode=GPIO, PortPinPcr=117
            PortPin_MCU_TO_SOC_INT_3V3: PortPinDirection=PORT_PIN_OUT, PortPinId=68, PortPinMode=GPIO, PortPinPcr=99
            PortPin_SBC_LIN_RX: PortPinDirection=PORT_PIN_IN, PortPinId=79, PortPinMode=GPIO, PortPinPcr=113
            PortPin_SOC_RES_OUT: PortPinDirection=PORT_PIN_IN, PortPinId=78, PortPinMode=GPIO, PortPinPcr=110
            PortPin_SOC_TO_MCU_INT_3V3: PortPinDirection=PORT_PIN_IN, PortPinId=67, PortPinMode=GPIO, PortPinPcr=98
            PortPin_VBAT_CUR_MONITOR: PortPinDirection=PORT_PIN_IN, PortPinId=84, PortPinMode=ADC1_SE20, PortPinPcr=120
            PortPin_WDOFF_EN: PortPinDirection=PORT_PIN_OUT, PortPinId=91, PortPinMode=GPIO, PortPinPcr=127
        PortE: PortNumberOfPortPins=23
          23 x PortPin, all with PortPinDSE=Low_Drive_Strength, PortPinDirectionChangeable=1, PortPinInitialMode=PORT_GPIO_MODE, PortPinLK=0, PortPinModeChangeable=1, PortPinPFE=0:
            PortPin_AUDIO_PA1_FAULT: PortPinDirection=PORT_PIN_IN, PortPinId=109, PortPinLevelValue=PORT_PIN_LEVEL_LOW, PortPinMode=GPIO, PortPinPE=PullDisabled, PortPinPS=PullDown, PortPinPcr=149
            PortPin_AUDIO_PA1_WARN: PortPinDirection=PORT_PIN_IN, PortPinId=110, PortPinLevelValue=PORT_PIN_LEVEL_LOW, PortPinMode=GPIO, PortPinPE=PullDisabled, PortPinPS=PullDown, PortPinPcr=150
            PortPin_AUDIO_PA2_FAULT: PortPinDirection=PORT_PIN_IN, PortPinId=111, PortPinLevelValue=PORT_PIN_LEVEL_LOW, PortPinMode=GPIO, PortPinPE=PullDisabled, PortPinPS=PullDown, PortPinPcr=151
            PortPin_AUDIO_PA2_WARN: PortPinDirection=PORT_PIN_IN, PortPinId=112, PortPinLevelValue=PORT_PIN_LEVEL_LOW, PortPinMode=GPIO, PortPinPE=PullDisabled, PortPinPS=PullDown, PortPinPcr=152
            PortPin_CHARGE_INT: PortPinDirection=PORT_PIN_IN, PortPinId=108, PortPinLevelValue=PORT_PIN_LEVEL_LOW, PortPinMode=GPIO, PortPinPE=PullDisabled, PortPinPS=PullDown, PortPinPcr=148
            PortPin_DSI0_1V2_PGOOD: PortPinDirection=PORT_PIN_IN, PortPinId=113, PortPinLevelValue=PORT_PIN_LEVEL_LOW, PortPinMode=GPIO, PortPinPE=PullDisabled, PortPinPS=PullDown, PortPinPcr=154
            PortPin_DSI1_1V2_PGOOD: PortPinDirection=PORT_PIN_IN, PortPinId=114, PortPinLevelValue=PORT_PIN_LEVEL_LOW, PortPinMode=GPIO, PortPinPE=PullDisabled, PortPinPS=PullDown, PortPinPcr=155
            PortPin_FAN_ALERT: PortPinDirection=PORT_PIN_IN, PortPinId=101, PortPinLevelValue=PORT_PIN_LEVEL_LOW, PortPinMode=GPIO, PortPinPE=PullDisabled, PortPinPS=PullDown, PortPinPcr=139
            PortPin_FAN_FAULT: PortPinDirection=PORT_PIN_OUT, PortPinId=100, PortPinLevelValue=PORT_PIN_LEVEL_LOW, PortPinMode=GPIO, PortPinPE=PullDisabled, PortPinPS=PullDown, PortPinPcr=138
            PortPin_I2S_PA_SYNC: PortPinDirection=PORT_PIN_OUT, PortPinId=94, PortPinLevelValue=PORT_PIN_LEVEL_LOW, PortPinMode=GPIO, PortPinPE=PullDisabled, PortPinPS=PullDown, PortPinPcr=130
            PortPin_MCU_CAN0_RX: PortPinDirection=PORT_PIN_IN, PortPinId=96, PortPinLevelValue=PORT_PIN_LEVEL_HIGH, PortPinMode=CAN0_RX, PortPinPE=PullEnabled, PortPinPS=PullUp, PortPinPcr=132
            PortPin_MCU_CAN0_STB: PortPinDirection=PORT_PIN_OUT, PortPinId=95, PortPinLevelValue=PORT_PIN_LEVEL_LOW, PortPinMode=GPIO, PortPinPE=PullDisabled, PortPinPS=PullDown, PortPinPcr=131
            PortPin_MCU_CAN0_TX: PortPinDirection=PORT_PIN_OUT, PortPinId=97, PortPinLevelValue=PORT_PIN_LEVEL_HIGH, PortPinMode=CAN0_TX, PortPinPE=PullEnabled, PortPinPS=PullUp, PortPinPcr=133
            PortPin_MCU_HVEN: PortPinDirection=PORT_PIN_IN, PortPinId=107, PortPinLevelValue=PORT_PIN_LEVEL_LOW, PortPinMode=GPIO, PortPinPE=PullDisabled, PortPinPS=PullDown, PortPinPcr=147
            PortPin_MCU_MII_MDC: PortPinDirection=PORT_PIN_HIGH_Z, PortPinId=99, PortPinLevelValue=PORT_PIN_LEVEL_LOW, PortPinMode=MII_RMII_MDC, PortPinPE=PullDisabled, PortPinPS=PullDown, PortPinPcr=136
            PortPin_MCU_SENSOR_I2C_SCL: PortPinDirection=PORT_PIN_OUT, PortPinId=93, PortPinLevelValue=PORT_PIN_LEVEL_LOW, PortPinMode=LPI2C1_SCL, PortPinPE=PullDisabled, PortPinPS=PullDown, PortPinPcr=129
            PortPin_MCU_SENSOR_I2C_SDA: PortPinDirection=PORT_PIN_OUT, PortPinId=92, PortPinLevelValue=PORT_PIN_LEVEL_LOW, PortPinMode=LPI2C1_SDA, PortPinPE=PullDisabled, PortPinPS=PullDown, PortPinPcr=128
            PortPin_PA_PWR_EN: PortPinDirection=PORT_PIN_OUT, PortPinId=98, PortPinLevelValue=PORT_PIN_LEVEL_LOW, PortPinMode=GPIO, PortPinPE=PullDisabled, PortPinPS=PullDown, PortPinPcr=135
            PortPin_SBC_INT: PortPinDirection=PORT_PIN_IN, PortPinId=106, PortPinLevelValue=PORT_PIN_LEVEL_LOW, PortPinMode=GPIO, PortPinPE=PullDisabled, PortPinPS=PullDown, PortPinPcr=145
            PortPin_SBC_LIN_TX: PortPinDirection=PORT_PIN_OUT, PortPinId=102, PortPinLevelValue=PORT_PIN_LEVEL_HIGH, PortPinMode=GPIO, PortPinPE=PullDisabled, PortPinPS=PullDown, PortPinPcr=140
            PortPin_SPI_MCU_SOC_CS: PortPinDirection=PORT_PIN_IN, PortPinId=103, PortPinLevelValue=PORT_PIN_LEVEL_LOW, PortPinMode=LPSPI2_PCS2, PortPinPE=PullDisabled, PortPinPS=PullDown, PortPinPcr=141
            PortPin_SPI_MCU_SOC_MOSI: PortPinDirection=PORT_PIN_OUT, PortPinId=105, PortPinLevelValue=PORT_PIN_LEVEL_LOW, PortPinMode=LPSPI2_SIN, PortPinPE=PullDisabled, PortPinPS=PullDown, PortPinPcr=144
            PortPin_SPI_MCU_SOC_SCLK: PortPinDirection=PORT_PIN_IN, PortPinId=104, PortPinLevelValue=PORT_PIN_LEVEL_LOW, PortPinMode=LPSPI2_SCK, PortPinPE=PullDisabled, PortPinPS=PullDown, PortPinPcr=143
      7 x UnTouchedPortPin:
        EXTAL: PortPinPcr=39
        PortPin_JTAG_TCLK: PortPinPcr=68
        PortPin_JTAG_TDI: PortPinPcr=69
        PortPin_JTAG_TDO: PortPinPcr=10
        PortPin_JTAG_TMS: PortPinPcr=4
        PortPin_RESET: PortPinPcr=5
        XTAL: PortPinPcr=38
    PortGeneral:
      PortCiPortIPDevErrorDetect = 0
      PortDevErrorDetect = 1
      PortEnableUserModeSupport = 0
      PortMulticoreSupport = 0
      PortResetPinModeApi = 0
      PortSet2PinsDirectionApi = 0
      PortSetAsUnusedPinApi = 0
      PortSetPinDirectionApi = 1
      PortSetPinModeApi = 1
      PortSetPinModeDoesNotTouchGpioLevel = 0
      PortVersionInfoApi = 1
package /Mcu
  module config Mcu: implementation-config-variant=VARIANT-POST-BUILD
    CommonPublishedInformation:
      ArReleaseMajorVersion = 4
      ArReleaseMinorVersion = 4
      ArReleaseRevisionVersion = 0
      ModuleId = 101
      SwMajorVersion = 1
      SwMinorVersion = 0
      SwPatchVersion = 1
      VendorApiInfix = 
      VendorId = 43
    McuDebugConfiguration:
      McuDisableCmuApi = 0
      McuDisableDemReportErrorStatus = 0
      McuEnablePeripheralCMU = 0
      McuGetClockFrequencyApi = 0
      McuGetMidrStructureApi = 0
      McuGetPowerModeStatetApi = 0
      McuSRAMRetentionConfigApi = 0
    McuGeneralConfiguration:
      McuCalloutBeforePerformReset = 0
      McuCmuErrorIsrUsed = 0
      McuDevErrorDetect = 0
      McuDisablePmcInit = 0
      McuDisableRcmInit = 0
      McuDisableSmcInit = 0
      McuEnableModeChangeNotification = 0
      McuEnableUserModeSupport = 0
      McuEnterLowPowerMode = 1
      McuGetRamStateApi = 0
      McuInitClock = 1
      McuNoPll = 1
      McuPerformResetApi = 0
      McuPerformResetCallout = NULL_PTR
      McuTimeout = 50000
      McuTimeoutMethod = OSIF_COUNTER_DUMMY
      McuVersionInfoApi = 0
    McuModuleConfiguration:
      McuClockSrcFailureNotification = DISABLED
      McuNumberOfMcuModes = 1
      McuRTC_CLKINFrequencyHz = 32768.0
      McuRamSectors = 0
      McuTCLK{0..2}_REF_CLKFrequencyHz = 32000.0
      McuAllowedModes: McuAllowHighSpeedRunMode=0, McuAllowVeryLowPowerModes=0
      McuClockSettingConfig_0 (McuClockSettingConfig): McuClockSettingId=0, McuScgClkOutSelect=FIRC_CLK, McuSysClockUnderMcuControl=1
        McuClkMonitor
          McuClkMonitor_0: McuAsyncFHHInterruptEn=0, McuAsyncFLLInterruptEn=0, McuClkMonitorEn=0, McuClockMonitorUnderMcuControl=0, McuCmuName=CMU_FC_0_FIRC_MON1_CLK
          McuClkMonitor_1: McuClkMonitorEn=0, McuClockMonitorUnderMcuControl=0, McuCmuName=CMU_FC_1_FIRC_MON2_CLK, McuSyncFHHInterruptEn=0, McuSyncFLLInterruptEn=0
        7 x McuClockReferencePoint:
          McuClockReferencePoint_BUS_CLK: McuClockFrequencySelect=RUN_BUS_CLK, McuClockReferencePointFrequency=4.0E7
          McuClockReferencePoint_LPO128K_CLK: McuClockFrequencySelect=LPO_128K_CLK, McuClockReferencePointFrequency=128000.0
          McuClockReferencePoint_SIRCDIV2_CLK: McuClockFrequencySelect=SIRCDIV2_CLK, McuClockReferencePointFrequency=4000000.0
          McuClockReferencePoint_SIRC_CLK: McuClockFrequencySelect=SIRC_CLK, McuClockReferencePointFrequency=8000000.0
          McuClockReferencePoint_SOSCDIV2_CLK: McuClockFrequencySelect=SOSCDIV2_CLK, McuClockReferencePointFrequency=8000000.0
          McuClockReferencePoint_SPLLDIV2_CLK: McuClockFrequencySelect=SPLLDIV2_CLK, McuClockReferencePointFrequency=4.0E7
          McuClockReferencePoint_SYS_CLK: McuClockFrequencySelect=RUN_SYS_CLK, McuClockReferencePointFrequency=8.0E7
        McuFIRCClockConfig:
          McuFIRCDiv1 = 1
          McuFIRCDiv1Frequency = 4.8E7
          McuFIRCDiv2 = 2
          McuFIRCDiv2Frequency = 2.4E7
          McuFIRCEnable = 1
          McuFIRCFrequency = 4.8E7
          McuFIRCRangeSelect = TRIMMED_TO_48MHZ
          McuFIRCRegulatorEnable = 1
          McuFIRCUnderMcuControl = 0
        McuHsrunClockConfig:
          McuBusClockDivider = 1
          McuBusClockFrequency = 4.8E7
          McuCoreClockDivider = 1
          McuCoreClockFrequency = 4.8E7
          McuFlashClockFrequency = 2.4E7
          McuPreDivSystemClockFrequency = 4.8E7
          McuScgClkOutFrequency = 4.8E7
          McuSlowClockDivider = 2
          McuSystemClockFrequency = 4.8E7
          McuSystemClockSwitch = FIRC_CLK
        41 x McuPeripheralClockConfig, all with McuPeripheralClockDivider=1, McuPeripheralClockEnable=1, McuPeripheralClockUnderMcuControl=1, McuPeripheralFractionalDivider=1:
          McuPeripheralClockConfig_0: McuPerName=FTFC, McuPeripheralClockFrequency=0.0, McuPeripheralClockSelect=CLOCK_IS_OFF
          McuPeripheralClockConfig_1: McuPerName=DMAMUX0, McuPeripheralClockFrequency=0.0, McuPeripheralClockSelect=CLOCK_IS_OFF
          McuPeripheralClockConfig_10: McuPerName=PDB1, McuPeripheralClockFrequency=0.0, McuPeripheralClockSelect=CLOCK_IS_OFF
          McuPeripheralClockConfig_11: McuPerName=CRC0, McuPeripheralClockFrequency=0.0, McuPeripheralClockSelect=CLOCK_IS_OFF
          McuPeripheralClockConfig_12: McuPerName=PDB0, McuPeripheralClockFrequency=0.0, McuPeripheralClockSelect=CLOCK_IS_OFF
          McuPeripheralClockConfig_13: McuPerName=LPIT0, McuPeripheralClockFrequency=8000000.0, McuPeripheralClockSelect=SOSC
          McuPeripheralClockConfig_14: McuPerName=FTM0, McuPeripheralClockFrequency=8000000.0, McuPeripheralClockSelect=SIRC
          McuPeripheralClockConfig_15: McuPerName=FTM1, McuPeripheralClockFrequency=8000000.0, McuPeripheralClockSelect=SIRC
          McuPeripheralClockConfig_16: McuPerName=FTM2, McuPeripheralClockFrequency=8000000.0, McuPeripheralClockSelect=SIRC
          McuPeripheralClockConfig_17: McuPerName=ADC0, McuPeripheralClockFrequency=4.0E7, McuPeripheralClockSelect=SPLL
          McuPeripheralClockConfig_18: McuPerName=RTC0, McuPeripheralClockFrequency=0.0, McuPeripheralClockSelect=CLOCK_IS_OFF
          McuPeripheralClockConfig_19: McuPerName=LPTMR0, McuPeripheralClockFrequency=4000000.0, McuPeripheralClockSelect=SIRC
          McuPeripheralClockConfig_2: McuPerName=FLEXCAN0, McuPeripheralClockFrequency=0.0, McuPeripheralClockSelect=CLOCK_IS_OFF
          McuPeripheralClockConfig_20: McuPerName=PORTA, McuPeripheralClockFrequency=0.0, McuPeripheralClockSelect=CLOCK_IS_OFF
          McuPeripheralClockConfig_21: McuPerName=PORTB, McuPeripheralClockFrequency=0.0, McuPeripheralClockSelect=CLOCK_IS_OFF
          McuPeripheralClockConfig_22: McuPerName=PORTC, McuPeripheralClockFrequency=0.0, McuPeripheralClockSelect=CLOCK_IS_OFF
          McuPeripheralClockConfig_23: McuPerName=PORTD, McuPeripheralClockFrequency=0.0, McuPeripheralClockSelect=CLOCK_IS_OFF
          McuPeripheralClockConfig_24: McuPerName=PORTE, McuPeripheralClockFrequency=0.0, McuPeripheralClockSelect=CLOCK_IS_OFF
          McuPeripheralClockConfig_25: McuPerName=SAI0, McuPeripheralClockFrequency=0.0, McuPeripheralClockSelect=CLOCK_IS_OFF
          McuPeripheralClockConfig_26: McuPerName=SAI1, McuPeripheralClockFrequency=0.0, McuPeripheralClockSelect=CLOCK_IS_OFF
          McuPeripheralClockConfig_27: McuPerName=FlexIO, McuPeripheralClockFrequency=8000000.0, McuPeripheralClockSelect=SOSC
          McuPeripheralClockConfig_28: McuPerName=EWM0, McuPeripheralClockFrequency=0.0, McuPeripheralClockSelect=CLOCK_IS_OFF
          McuPeripheralClockConfig_29: McuPerName=LPI2C0, McuPeripheralClockFrequency=0.0, McuPeripheralClockSelect=CLOCK_IS_OFF
          McuPeripheralClockConfig_3: McuPerName=FLEXCAN1, McuPeripheralClockFrequency=0.0, McuPeripheralClockSelect=CLOCK_IS_OFF
          McuPeripheralClockConfig_30: McuPerName=LPI2C1, McuPeripheralClockFrequency=4000000.0, McuPeripheralClockSelect=SIRC
          McuPeripheralClockConfig_31: McuPerName=LPUART0, McuPeripheralClockFrequency=8000000.0, McuPeripheralClockSelect=SOSC
          McuPeripheralClockConfig_32: McuPerName=LPUART1, McuPeripheralClockFrequency=8000000.0, McuPeripheralClockSelect=SOSC
          McuPeripheralClockConfig_33: McuPerName=LPUART2, McuPeripheralClockFrequency=8000000.0, McuPeripheralClockSelect=SOSC
          McuPeripheralClockConfig_34: McuPerName=FTM4, McuPeripheralClockFrequency=32000.0, McuPeripheralClockSelect=CLOCK_IS_OFF
          McuPeripheralClockConfig_35: McuPerName=FTM5, McuPeripheralClockFrequency=32000.0, McuPeripheralClockSelect=CLOCK_IS_OFF
          McuPeripheralClockConfig_36: McuPerName=FTM6, McuPeripheralClockFrequency=32000.0, McuPeripheralClockSelect=CLOCK_IS_OFF
          McuPeripheralClockConfig_37: McuPerName=FTM7, McuPeripheralClockFrequency=32000.0, McuPeripheralClockSelect=CLOCK_IS_OFF
          McuPeripheralClockConfig_38: McuPerName=CMP0, McuPeripheralClockFrequency=0.0, McuPeripheralClockSelect=CLOCK_IS_OFF
          McuPeripheralClockConfig_39: McuPerName=QSPI, McuPeripheralClockFrequency=0.0, McuPeripheralClockSelect=CLOCK_IS_OFF
          McuPeripheralClockConfig_4: McuPerName=FTM3, McuPeripheralClockFrequency=8000000.0, McuPeripheralClockSelect=SIRC
          McuPeripheralClockConfig_40: McuPerName=ENET, McuPeripheralClockFrequency=0.0, McuPeripheralClockSelect=CLOCK_IS_OFF
          McuPeripheralClockConfig_5: McuPerName=ADC1, McuPeripheralClockFrequency=4.0E7, McuPeripheralClockSelect=SPLL
          McuPeripheralClockConfig_6: McuPerName=FLEXCAN2, McuPeripheralClockFrequency=0.0, McuPeripheralClockSelect=CLOCK_IS_OFF
          McuPeripheralClockConfig_7: McuPerName=LPSPI0, McuPeripheralClockFrequency=4.0E7, McuPeripheralClockSelect=SPLL
          McuPeripheralClockConfig_8: McuPerName=LPSPI1, McuPeripheralClockFrequency=4.0E7, McuPeripheralClockSelect=SPLL
          McuPeripheralClockConfig_9: McuPerName=LPSPI2, McuPeripheralClockFrequency=4.0E7, McuPeripheralClockSelect=SPLL
        McuRunClockConfig:
          McuBusClockDivider = 2
          McuBusClockFrequency = 4.0E7
          McuCoreClockDivider = 2
          McuCoreClockFrequency = 8.0E7
          McuFlashClockFrequency = 2.6666666E7
          McuPreDivSystemClockFrequency = 1.6E8
          McuScgClkOutFrequency = 4.8E7
          McuSlowClockDivider = 3
          McuSystemClockFrequency = 8.0E7
          McuSystemClockSwitch = SPLL_CLK
        McuSIMClockConfig:
          McuDMAClockGatingEnable = 1
          McuEIMClockGatingEnable = 1
          McuERMClockGatingEnable = 1
          McuGPIOClockGatingEnable = 0
          McuMPUClockGatingEnable = 1
          McuMSCMClockGatingEnable = 1
          McuSIMUnderMcuControl = 1
          McuSimChipConfiguration:
            McuCLKOUTDivider = 8
            McuCLKOUTEnable = 0
            McuCLKOUTSelect = BUS_CLK
            McuDebugTraceDividerEnable = 1
            McuTRACECLKDivider = 1
            McuTRACECLKFraction = 1
            McuTRACECLKSelect = CORE_CLK
          McuSimFtmConfiguration:
            McuFTM{0..7}ExternalClockPinSelect = TCLK0_PIN
          McuSimLpoConfiguration: McuLPOClkSelect=LPO_128K_CLK, McuLPO_1KClockEnable=1, McuLPO_32KClockEnable=1, McuRTCClkSelect=SOSCDIV1_CLK
        McuSIRCClockConfig:
          McuSIRCDiv1 = 1
          McuSIRCDiv1Frequency = 8000000.0
          McuSIRCDiv2 = 2
          McuSIRCDiv2Frequency = 4000000.0
          McuSIRCEnable = 1
          McuSIRCFrequency = 8000000.0
          McuSIRCLowPowerEnable = 1
          McuSIRCRangeSelect = HIGH_RANGE_CLOCK
          McuSIRCStopEnable = 0
          McuSIRCUnderMcuControl = 0
        McuSystemOSCClockConfig:
          McuSOSCClockMonitorEnable = 0
          McuSOSCClockMonitorResetEnable = 0
          McuSOSCDiv1 = 1
          McuSOSCDiv1Frequency = 8000000.0
          McuSOSCDiv2 = 1
          McuSOSCDiv2Frequency = 8000000.0
          McuSOSCEnable = 1
          McuSOSCExternalReferenceSelect = 1
          McuSOSCFrequency = 8000000.0
          McuSOSCHighGainOscillatorSelect = 0
          McuSOSCRangeSelect = HIGH_FREQ_RANGE
          McuSOSCUnderMcuControl = 1
        McuSystemPll:
          McuSPLLClockMonitorEnable = 0
          McuSPLLClockMonitorResetEnable = 0
          McuSPLLDiv1 = 2
          McuSPLLDiv1Frequency = 8.0E7
          McuSPLLDiv2 = 4
          McuSPLLDiv2Frequency = 4.0E7
          McuSPLLEnable = 0
          McuSPLLFrequency = 1.6E8
          McuSPLLInputClkPreDivider = 1
          McuSPLLInputFrequency = 8000000.0
          McuSPLLMultiplier = 40
          McuSPLLReferenceFrequency = 8000000.0
          McuSPLLSelectSourceClock = SOSC_CLK
          McuSystemPllUnderMcuControl = 0
        McuVlprClockConfig:
          McuBusClockDivider = 1
          McuBusClockFrequency = 4000000.0
          McuCoreClockDivider = 2
          McuCoreClockFrequency = 4000000.0
          McuFlashClockFrequency = 1000000.0
          McuPreDivSystemClockFrequency = 8000000.0
          McuScgClkOutFrequency = 0.0
          McuSlowClockDivider = 4
          McuSystemClockFrequency = 4000000.0
          McuSystemClockSwitch = SIRC_CLK
      McuInterruptEvents: McuAlternateResetEvent=0, McuVoltageErrorEvent=0
      McuModeSettingConf_0 (McuModeSettingConf): McuEnableSleepOnExit=0, McuMode=0, McuPowerMode=RUN
      McuPowerControl:
        McuClockBiasDisable = 0
        McuLPODisable = 0
        McuLowPowerBiasEnable = 0
        McuLowVoltageDetectInterruptEnable = 0
        McuLowVoltageDetectResetEnable = 0
        McuLowVoltageWarningInterruptEnable = 0
      McuResetConfig: McuResetPinFilterBusClockSelect=0, McuResetPinFilterInRunAndWait=ALL_FILTERING_DISABLE, McuResetPinFilterInStopMode=ALL_FILTERING_DISABLE
        McuSystemInterruptEnable:
          McuCMULossOfClockResetInterrupt = 0
          McuCoreLockupInterrupt = 0
          McuExternalResetPinInterrupt = 0
          McuGlobalInterrupt = 0
          McuJTAGResetInterrupt = 0
          McuLossOfClockInterrupt = 0
          McuLossOfLockInterrupt = 0
          McuMDMAPSystemResetInterrupt = 0
          McuResetDelayTime = DELAY_10_LPO_CYCLES
          McuSoftwareInterrupt = 0
          McuStopAcknowledgeErrorInterrupt = 0
          McuWatchdogInterrupt = 0
    McuPublishedInformation
      15 x McuResetReasonConf:
        MCU_CMU_LOSS_OF_CLOCK_RESET: McuResetReason=8
        MCU_CORE_LOCKUP_RESET: McuResetReason=3
        MCU_EXTERNAL_PIN_RESET: McuResetReason=6
        MCU_JTAG_RESET: McuResetReason=4
        MCU_LOSS_OF_CLOCK_RESET: McuResetReason=10
        MCU_LOSS_OF_LOCK_RESET: McuResetReason=9
        MCU_LOW_OR_HIGH_VOLTAGE_DETECT_RESET: McuResetReason=11
        MCU_MDM_AP_SYSTEM_RESET: McuResetReason=1
        MCU_MULTIPLE_RESET_REASON: McuResetReason=13
        MCU_NO_RESET_REASON: McuResetReason=12
        MCU_POWER_ON_RESET: McuResetReason=5
        MCU_RESET_UNDEFINED: McuResetReason=14
        MCU_STOP_ACKNOWLEDGE_ERROR_RESET: McuResetReason=0
        MCU_SW_RESET: McuResetReason=2
        MCU_WATCHDOG_RESET: McuResetReason=7
package /Wdg
  module config Wdg: implementation-config-variant=VARIANT-LINK-TIME
    CommonPublishedInformation:
      ArReleaseMajorVersion = 4
      ArReleaseMinorVersion = 4
      ArReleaseRevisionVersion = 0
      ModuleId = 102
      SwMajorVersion = 1
      SwMinorVersion = 0
      SwPatchVersion = 1
      VendorApiInfix = Instance0
      VendorId = 43
    WdgClockReferencePoint_0 (WdgClockReferencePoint): WdgClockReference=McuClockReferencePoint_LPO128K_CLK
    WdgGeneral:
      WdgCallbackNotification = NULL_PTR
      WdgDevErrorDetect = 1
      WdgDisableAllowed = 0
      WdgEnableDirectService = 0
      WdgEnableMultiCoreSupport = 0
      WdgEnableUserModeSupport = 0
      WdgIndex = 0
      WdgInitialTimeout = 0.2
      WdgMaxTimeout = 10.0
      WdgOsifTimeoutVal = 3000
      WdgRunArea = ROM
      WdgTimeoutMethod = OSIF_COUNTER_DUMMY
      WdgTriggerLocation = NULL_PTR
      WdgVersionInfoApi = 1
      AutosarExt: WdgDisableDemReportErrorStatus=1
    WdgPublishedInformation: WdgTriggerMode=WDG_BOTH
    WdgSettingsConfig: WdgDefaultMode=WDGIF_SLOW_MODE, WdgInstance=WDOG, WdgInterruptContentEnable=1, WdgExternalTriggerCounterRef=GptChannelConfiguration_WdgTrig
      WdgSettingsFast:
        WdgAllowUpdates = 1
        WdgClockSelection = LPO_Clock
        WdgClockValue = 128
        WdgOperationMode = ResetOnTimeOut
        WdgPrescalerEnabled = 1
        WdgRunsInDebugMode = 0
        WdgRunsInStopMode = 0
        WdgRunsInWaitMode = 0
        WdgTimeoutPeriod = 0.2
        WdgWindowMode = 0
        WdgWindowPeriod = 0.0
        WdgClkSrcRef = Wdg/WdgClockReferencePoint_0
      WdgSettingsOff: WdgAllowUpdates=1
      WdgSettingsSlow:
        WdgAllowUpdates = 1
        WdgClockSelection = LPO_Clock
        WdgClockValue = 128
        WdgOperationMode = ResetOnTimeOut
        WdgPrescalerEnabled = 1
        WdgRunsInDebugMode = 0
        WdgRunsInStopMode = 0
        WdgRunsInWaitMode = 0
        WdgTimeoutPeriod = 0.5
        WdgWindowMode = 0
        WdgWindowPeriod = 0.0
        WdgClkSrcRef = Wdg/WdgClockReferencePoint_0
